/*******************************************************************************
* File Name: cyfittergnu.inc
* 
* PSoC Creator  4.2
*
* Description:
* 
* This file is automatically generated by PSoC Creator.
*
********************************************************************************
* Copyright (c) 2007-2018 Cypress Semiconductor.  All rights reserved.
* You may use this file only in accordance with the license, terms, conditions, 
* disclaimers, and limitations in the end user license agreement accompanying 
* the software package with which this file was provided.
********************************************************************************/

.ifndef INCLUDED_CYFITTERGNU_INC
.set INCLUDED_CYFITTERGNU_INC, 1
.include "cydevicegnu.inc"
.include "cydevicegnu_trm.inc"

/* LED_1 */
.set LED_1__0__INTTYPE, CYREG_PICU15_INTTYPE1
.set LED_1__0__MASK, 0x02
.set LED_1__0__PC, CYREG_IO_PC_PRT15_PC1
.set LED_1__0__PORT, 15
.set LED_1__0__SHIFT, 1
.set LED_1__AG, CYREG_PRT15_AG
.set LED_1__AMUX, CYREG_PRT15_AMUX
.set LED_1__BIE, CYREG_PRT15_BIE
.set LED_1__BIT_MASK, CYREG_PRT15_BIT_MASK
.set LED_1__BYP, CYREG_PRT15_BYP
.set LED_1__CTL, CYREG_PRT15_CTL
.set LED_1__DM0, CYREG_PRT15_DM0
.set LED_1__DM1, CYREG_PRT15_DM1
.set LED_1__DM2, CYREG_PRT15_DM2
.set LED_1__DR, CYREG_PRT15_DR
.set LED_1__INP_DIS, CYREG_PRT15_INP_DIS
.set LED_1__INTTYPE_BASE, CYDEV_PICU_INTTYPE_PICU15_BASE
.set LED_1__LCD_COM_SEG, CYREG_PRT15_LCD_COM_SEG
.set LED_1__LCD_EN, CYREG_PRT15_LCD_EN
.set LED_1__MASK, 0x02
.set LED_1__PORT, 15
.set LED_1__PRT, CYREG_PRT15_PRT
.set LED_1__PRTDSI__CAPS_SEL, CYREG_PRT15_CAPS_SEL
.set LED_1__PRTDSI__DBL_SYNC_IN, CYREG_PRT15_DBL_SYNC_IN
.set LED_1__PRTDSI__OE_SEL0, CYREG_PRT15_OE_SEL0
.set LED_1__PRTDSI__OE_SEL1, CYREG_PRT15_OE_SEL1
.set LED_1__PRTDSI__OUT_SEL0, CYREG_PRT15_OUT_SEL0
.set LED_1__PRTDSI__OUT_SEL1, CYREG_PRT15_OUT_SEL1
.set LED_1__PRTDSI__SYNC_OUT, CYREG_PRT15_SYNC_OUT
.set LED_1__PS, CYREG_PRT15_PS
.set LED_1__SHIFT, 1
.set LED_1__SLW, CYREG_PRT15_SLW

/* LED_2 */
.set LED_2__0__INTTYPE, CYREG_PICU15_INTTYPE2
.set LED_2__0__MASK, 0x04
.set LED_2__0__PC, CYREG_IO_PC_PRT15_PC2
.set LED_2__0__PORT, 15
.set LED_2__0__SHIFT, 2
.set LED_2__AG, CYREG_PRT15_AG
.set LED_2__AMUX, CYREG_PRT15_AMUX
.set LED_2__BIE, CYREG_PRT15_BIE
.set LED_2__BIT_MASK, CYREG_PRT15_BIT_MASK
.set LED_2__BYP, CYREG_PRT15_BYP
.set LED_2__CTL, CYREG_PRT15_CTL
.set LED_2__DM0, CYREG_PRT15_DM0
.set LED_2__DM1, CYREG_PRT15_DM1
.set LED_2__DM2, CYREG_PRT15_DM2
.set LED_2__DR, CYREG_PRT15_DR
.set LED_2__INP_DIS, CYREG_PRT15_INP_DIS
.set LED_2__INTTYPE_BASE, CYDEV_PICU_INTTYPE_PICU15_BASE
.set LED_2__LCD_COM_SEG, CYREG_PRT15_LCD_COM_SEG
.set LED_2__LCD_EN, CYREG_PRT15_LCD_EN
.set LED_2__MASK, 0x04
.set LED_2__PORT, 15
.set LED_2__PRT, CYREG_PRT15_PRT
.set LED_2__PRTDSI__CAPS_SEL, CYREG_PRT15_CAPS_SEL
.set LED_2__PRTDSI__DBL_SYNC_IN, CYREG_PRT15_DBL_SYNC_IN
.set LED_2__PRTDSI__OE_SEL0, CYREG_PRT15_OE_SEL0
.set LED_2__PRTDSI__OE_SEL1, CYREG_PRT15_OE_SEL1
.set LED_2__PRTDSI__OUT_SEL0, CYREG_PRT15_OUT_SEL0
.set LED_2__PRTDSI__OUT_SEL1, CYREG_PRT15_OUT_SEL1
.set LED_2__PRTDSI__SYNC_OUT, CYREG_PRT15_SYNC_OUT
.set LED_2__PS, CYREG_PRT15_PS
.set LED_2__SHIFT, 2
.set LED_2__SLW, CYREG_PRT15_SLW

/* LED_3 */
.set LED_3__0__INTTYPE, CYREG_PICU15_INTTYPE3
.set LED_3__0__MASK, 0x08
.set LED_3__0__PC, CYREG_IO_PC_PRT15_PC3
.set LED_3__0__PORT, 15
.set LED_3__0__SHIFT, 3
.set LED_3__AG, CYREG_PRT15_AG
.set LED_3__AMUX, CYREG_PRT15_AMUX
.set LED_3__BIE, CYREG_PRT15_BIE
.set LED_3__BIT_MASK, CYREG_PRT15_BIT_MASK
.set LED_3__BYP, CYREG_PRT15_BYP
.set LED_3__CTL, CYREG_PRT15_CTL
.set LED_3__DM0, CYREG_PRT15_DM0
.set LED_3__DM1, CYREG_PRT15_DM1
.set LED_3__DM2, CYREG_PRT15_DM2
.set LED_3__DR, CYREG_PRT15_DR
.set LED_3__INP_DIS, CYREG_PRT15_INP_DIS
.set LED_3__INTTYPE_BASE, CYDEV_PICU_INTTYPE_PICU15_BASE
.set LED_3__LCD_COM_SEG, CYREG_PRT15_LCD_COM_SEG
.set LED_3__LCD_EN, CYREG_PRT15_LCD_EN
.set LED_3__MASK, 0x08
.set LED_3__PORT, 15
.set LED_3__PRT, CYREG_PRT15_PRT
.set LED_3__PRTDSI__CAPS_SEL, CYREG_PRT15_CAPS_SEL
.set LED_3__PRTDSI__DBL_SYNC_IN, CYREG_PRT15_DBL_SYNC_IN
.set LED_3__PRTDSI__OE_SEL0, CYREG_PRT15_OE_SEL0
.set LED_3__PRTDSI__OE_SEL1, CYREG_PRT15_OE_SEL1
.set LED_3__PRTDSI__OUT_SEL0, CYREG_PRT15_OUT_SEL0
.set LED_3__PRTDSI__OUT_SEL1, CYREG_PRT15_OUT_SEL1
.set LED_3__PRTDSI__SYNC_OUT, CYREG_PRT15_SYNC_OUT
.set LED_3__PS, CYREG_PRT15_PS
.set LED_3__SHIFT, 3
.set LED_3__SLW, CYREG_PRT15_SLW

/* LED_4 */
.set LED_4__0__INTTYPE, CYREG_PICU15_INTTYPE0
.set LED_4__0__MASK, 0x01
.set LED_4__0__PC, CYREG_IO_PC_PRT15_PC0
.set LED_4__0__PORT, 15
.set LED_4__0__SHIFT, 0
.set LED_4__AG, CYREG_PRT15_AG
.set LED_4__AMUX, CYREG_PRT15_AMUX
.set LED_4__BIE, CYREG_PRT15_BIE
.set LED_4__BIT_MASK, CYREG_PRT15_BIT_MASK
.set LED_4__BYP, CYREG_PRT15_BYP
.set LED_4__CTL, CYREG_PRT15_CTL
.set LED_4__DM0, CYREG_PRT15_DM0
.set LED_4__DM1, CYREG_PRT15_DM1
.set LED_4__DM2, CYREG_PRT15_DM2
.set LED_4__DR, CYREG_PRT15_DR
.set LED_4__INP_DIS, CYREG_PRT15_INP_DIS
.set LED_4__INTTYPE_BASE, CYDEV_PICU_INTTYPE_PICU15_BASE
.set LED_4__LCD_COM_SEG, CYREG_PRT15_LCD_COM_SEG
.set LED_4__LCD_EN, CYREG_PRT15_LCD_EN
.set LED_4__MASK, 0x01
.set LED_4__PORT, 15
.set LED_4__PRT, CYREG_PRT15_PRT
.set LED_4__PRTDSI__CAPS_SEL, CYREG_PRT15_CAPS_SEL
.set LED_4__PRTDSI__DBL_SYNC_IN, CYREG_PRT15_DBL_SYNC_IN
.set LED_4__PRTDSI__OE_SEL0, CYREG_PRT15_OE_SEL0
.set LED_4__PRTDSI__OE_SEL1, CYREG_PRT15_OE_SEL1
.set LED_4__PRTDSI__OUT_SEL0, CYREG_PRT15_OUT_SEL0
.set LED_4__PRTDSI__OUT_SEL1, CYREG_PRT15_OUT_SEL1
.set LED_4__PRTDSI__SYNC_OUT, CYREG_PRT15_SYNC_OUT
.set LED_4__PS, CYREG_PRT15_PS
.set LED_4__SHIFT, 0
.set LED_4__SLW, CYREG_PRT15_SLW

/* LED_5 */
.set LED_5__0__INTTYPE, CYREG_PICU12_INTTYPE0
.set LED_5__0__MASK, 0x01
.set LED_5__0__PC, CYREG_PRT12_PC0
.set LED_5__0__PORT, 12
.set LED_5__0__SHIFT, 0
.set LED_5__AG, CYREG_PRT12_AG
.set LED_5__BIE, CYREG_PRT12_BIE
.set LED_5__BIT_MASK, CYREG_PRT12_BIT_MASK
.set LED_5__BYP, CYREG_PRT12_BYP
.set LED_5__DM0, CYREG_PRT12_DM0
.set LED_5__DM1, CYREG_PRT12_DM1
.set LED_5__DM2, CYREG_PRT12_DM2
.set LED_5__DR, CYREG_PRT12_DR
.set LED_5__INP_DIS, CYREG_PRT12_INP_DIS
.set LED_5__INTTYPE_BASE, CYDEV_PICU_INTTYPE_PICU12_BASE
.set LED_5__MASK, 0x01
.set LED_5__PORT, 12
.set LED_5__PRT, CYREG_PRT12_PRT
.set LED_5__PRTDSI__DBL_SYNC_IN, CYREG_PRT12_DBL_SYNC_IN
.set LED_5__PRTDSI__OE_SEL0, CYREG_PRT12_OE_SEL0
.set LED_5__PRTDSI__OE_SEL1, CYREG_PRT12_OE_SEL1
.set LED_5__PRTDSI__OUT_SEL0, CYREG_PRT12_OUT_SEL0
.set LED_5__PRTDSI__OUT_SEL1, CYREG_PRT12_OUT_SEL1
.set LED_5__PRTDSI__SYNC_OUT, CYREG_PRT12_SYNC_OUT
.set LED_5__PS, CYREG_PRT12_PS
.set LED_5__SHIFT, 0
.set LED_5__SIO_CFG, CYREG_PRT12_SIO_CFG
.set LED_5__SIO_DIFF, CYREG_PRT12_SIO_DIFF
.set LED_5__SIO_HYST_EN, CYREG_PRT12_SIO_HYST_EN
.set LED_5__SIO_REG_HIFREQ, CYREG_PRT12_SIO_REG_HIFREQ
.set LED_5__SLW, CYREG_PRT12_SLW

/* LED_6 */
.set LED_6__0__INTTYPE, CYREG_PICU12_INTTYPE1
.set LED_6__0__MASK, 0x02
.set LED_6__0__PC, CYREG_PRT12_PC1
.set LED_6__0__PORT, 12
.set LED_6__0__SHIFT, 1
.set LED_6__AG, CYREG_PRT12_AG
.set LED_6__BIE, CYREG_PRT12_BIE
.set LED_6__BIT_MASK, CYREG_PRT12_BIT_MASK
.set LED_6__BYP, CYREG_PRT12_BYP
.set LED_6__DM0, CYREG_PRT12_DM0
.set LED_6__DM1, CYREG_PRT12_DM1
.set LED_6__DM2, CYREG_PRT12_DM2
.set LED_6__DR, CYREG_PRT12_DR
.set LED_6__INP_DIS, CYREG_PRT12_INP_DIS
.set LED_6__INTTYPE_BASE, CYDEV_PICU_INTTYPE_PICU12_BASE
.set LED_6__MASK, 0x02
.set LED_6__PORT, 12
.set LED_6__PRT, CYREG_PRT12_PRT
.set LED_6__PRTDSI__DBL_SYNC_IN, CYREG_PRT12_DBL_SYNC_IN
.set LED_6__PRTDSI__OE_SEL0, CYREG_PRT12_OE_SEL0
.set LED_6__PRTDSI__OE_SEL1, CYREG_PRT12_OE_SEL1
.set LED_6__PRTDSI__OUT_SEL0, CYREG_PRT12_OUT_SEL0
.set LED_6__PRTDSI__OUT_SEL1, CYREG_PRT12_OUT_SEL1
.set LED_6__PRTDSI__SYNC_OUT, CYREG_PRT12_SYNC_OUT
.set LED_6__PS, CYREG_PRT12_PS
.set LED_6__SHIFT, 1
.set LED_6__SIO_CFG, CYREG_PRT12_SIO_CFG
.set LED_6__SIO_DIFF, CYREG_PRT12_SIO_DIFF
.set LED_6__SIO_HYST_EN, CYREG_PRT12_SIO_HYST_EN
.set LED_6__SIO_REG_HIFREQ, CYREG_PRT12_SIO_REG_HIFREQ
.set LED_6__SLW, CYREG_PRT12_SLW

/* LED_7 */
.set LED_7__0__INTTYPE, CYREG_PICU12_INTTYPE2
.set LED_7__0__MASK, 0x04
.set LED_7__0__PC, CYREG_PRT12_PC2
.set LED_7__0__PORT, 12
.set LED_7__0__SHIFT, 2
.set LED_7__AG, CYREG_PRT12_AG
.set LED_7__BIE, CYREG_PRT12_BIE
.set LED_7__BIT_MASK, CYREG_PRT12_BIT_MASK
.set LED_7__BYP, CYREG_PRT12_BYP
.set LED_7__DM0, CYREG_PRT12_DM0
.set LED_7__DM1, CYREG_PRT12_DM1
.set LED_7__DM2, CYREG_PRT12_DM2
.set LED_7__DR, CYREG_PRT12_DR
.set LED_7__INP_DIS, CYREG_PRT12_INP_DIS
.set LED_7__INTTYPE_BASE, CYDEV_PICU_INTTYPE_PICU12_BASE
.set LED_7__MASK, 0x04
.set LED_7__PORT, 12
.set LED_7__PRT, CYREG_PRT12_PRT
.set LED_7__PRTDSI__DBL_SYNC_IN, CYREG_PRT12_DBL_SYNC_IN
.set LED_7__PRTDSI__OE_SEL0, CYREG_PRT12_OE_SEL0
.set LED_7__PRTDSI__OE_SEL1, CYREG_PRT12_OE_SEL1
.set LED_7__PRTDSI__OUT_SEL0, CYREG_PRT12_OUT_SEL0
.set LED_7__PRTDSI__OUT_SEL1, CYREG_PRT12_OUT_SEL1
.set LED_7__PRTDSI__SYNC_OUT, CYREG_PRT12_SYNC_OUT
.set LED_7__PS, CYREG_PRT12_PS
.set LED_7__SHIFT, 2
.set LED_7__SIO_CFG, CYREG_PRT12_SIO_CFG
.set LED_7__SIO_DIFF, CYREG_PRT12_SIO_DIFF
.set LED_7__SIO_HYST_EN, CYREG_PRT12_SIO_HYST_EN
.set LED_7__SIO_REG_HIFREQ, CYREG_PRT12_SIO_REG_HIFREQ
.set LED_7__SLW, CYREG_PRT12_SLW

/* M1_D1 */
.set M1_D1__0__INTTYPE, CYREG_PICU3_INTTYPE3
.set M1_D1__0__MASK, 0x08
.set M1_D1__0__PC, CYREG_PRT3_PC3
.set M1_D1__0__PORT, 3
.set M1_D1__0__SHIFT, 3
.set M1_D1__AG, CYREG_PRT3_AG
.set M1_D1__AMUX, CYREG_PRT3_AMUX
.set M1_D1__BIE, CYREG_PRT3_BIE
.set M1_D1__BIT_MASK, CYREG_PRT3_BIT_MASK
.set M1_D1__BYP, CYREG_PRT3_BYP
.set M1_D1__CTL, CYREG_PRT3_CTL
.set M1_D1__DM0, CYREG_PRT3_DM0
.set M1_D1__DM1, CYREG_PRT3_DM1
.set M1_D1__DM2, CYREG_PRT3_DM2
.set M1_D1__DR, CYREG_PRT3_DR
.set M1_D1__INP_DIS, CYREG_PRT3_INP_DIS
.set M1_D1__INTTYPE_BASE, CYDEV_PICU_INTTYPE_PICU3_BASE
.set M1_D1__LCD_COM_SEG, CYREG_PRT3_LCD_COM_SEG
.set M1_D1__LCD_EN, CYREG_PRT3_LCD_EN
.set M1_D1__MASK, 0x08
.set M1_D1__PORT, 3
.set M1_D1__PRT, CYREG_PRT3_PRT
.set M1_D1__PRTDSI__CAPS_SEL, CYREG_PRT3_CAPS_SEL
.set M1_D1__PRTDSI__DBL_SYNC_IN, CYREG_PRT3_DBL_SYNC_IN
.set M1_D1__PRTDSI__OE_SEL0, CYREG_PRT3_OE_SEL0
.set M1_D1__PRTDSI__OE_SEL1, CYREG_PRT3_OE_SEL1
.set M1_D1__PRTDSI__OUT_SEL0, CYREG_PRT3_OUT_SEL0
.set M1_D1__PRTDSI__OUT_SEL1, CYREG_PRT3_OUT_SEL1
.set M1_D1__PRTDSI__SYNC_OUT, CYREG_PRT3_SYNC_OUT
.set M1_D1__PS, CYREG_PRT3_PS
.set M1_D1__SHIFT, 3
.set M1_D1__SLW, CYREG_PRT3_SLW

/* M2_D1 */
.set M2_D1__0__INTTYPE, CYREG_PICU1_INTTYPE2
.set M2_D1__0__MASK, 0x04
.set M2_D1__0__PC, CYREG_PRT1_PC2
.set M2_D1__0__PORT, 1
.set M2_D1__0__SHIFT, 2
.set M2_D1__AG, CYREG_PRT1_AG
.set M2_D1__AMUX, CYREG_PRT1_AMUX
.set M2_D1__BIE, CYREG_PRT1_BIE
.set M2_D1__BIT_MASK, CYREG_PRT1_BIT_MASK
.set M2_D1__BYP, CYREG_PRT1_BYP
.set M2_D1__CTL, CYREG_PRT1_CTL
.set M2_D1__DM0, CYREG_PRT1_DM0
.set M2_D1__DM1, CYREG_PRT1_DM1
.set M2_D1__DM2, CYREG_PRT1_DM2
.set M2_D1__DR, CYREG_PRT1_DR
.set M2_D1__INP_DIS, CYREG_PRT1_INP_DIS
.set M2_D1__INTTYPE_BASE, CYDEV_PICU_INTTYPE_PICU1_BASE
.set M2_D1__LCD_COM_SEG, CYREG_PRT1_LCD_COM_SEG
.set M2_D1__LCD_EN, CYREG_PRT1_LCD_EN
.set M2_D1__MASK, 0x04
.set M2_D1__PORT, 1
.set M2_D1__PRT, CYREG_PRT1_PRT
.set M2_D1__PRTDSI__CAPS_SEL, CYREG_PRT1_CAPS_SEL
.set M2_D1__PRTDSI__DBL_SYNC_IN, CYREG_PRT1_DBL_SYNC_IN
.set M2_D1__PRTDSI__OE_SEL0, CYREG_PRT1_OE_SEL0
.set M2_D1__PRTDSI__OE_SEL1, CYREG_PRT1_OE_SEL1
.set M2_D1__PRTDSI__OUT_SEL0, CYREG_PRT1_OUT_SEL0
.set M2_D1__PRTDSI__OUT_SEL1, CYREG_PRT1_OUT_SEL1
.set M2_D1__PRTDSI__SYNC_OUT, CYREG_PRT1_SYNC_OUT
.set M2_D1__PS, CYREG_PRT1_PS
.set M2_D1__SHIFT, 2
.set M2_D1__SLW, CYREG_PRT1_SLW

/* PWM_1 */
.set PWM_1_PWMHW__CAP0, CYREG_TMR0_CAP0
.set PWM_1_PWMHW__CAP1, CYREG_TMR0_CAP1
.set PWM_1_PWMHW__CFG0, CYREG_TMR0_CFG0
.set PWM_1_PWMHW__CFG1, CYREG_TMR0_CFG1
.set PWM_1_PWMHW__CFG2, CYREG_TMR0_CFG2
.set PWM_1_PWMHW__CNT_CMP0, CYREG_TMR0_CNT_CMP0
.set PWM_1_PWMHW__CNT_CMP1, CYREG_TMR0_CNT_CMP1
.set PWM_1_PWMHW__PER0, CYREG_TMR0_PER0
.set PWM_1_PWMHW__PER1, CYREG_TMR0_PER1
.set PWM_1_PWMHW__PM_ACT_CFG, CYREG_PM_ACT_CFG3
.set PWM_1_PWMHW__PM_ACT_MSK, 0x01
.set PWM_1_PWMHW__PM_STBY_CFG, CYREG_PM_STBY_CFG3
.set PWM_1_PWMHW__PM_STBY_MSK, 0x01
.set PWM_1_PWMHW__RT0, CYREG_TMR0_RT0
.set PWM_1_PWMHW__RT1, CYREG_TMR0_RT1
.set PWM_1_PWMHW__SR0, CYREG_TMR0_SR0

/* PWM_2 */
.set PWM_2_PWMHW__CAP0, CYREG_TMR1_CAP0
.set PWM_2_PWMHW__CAP1, CYREG_TMR1_CAP1
.set PWM_2_PWMHW__CFG0, CYREG_TMR1_CFG0
.set PWM_2_PWMHW__CFG1, CYREG_TMR1_CFG1
.set PWM_2_PWMHW__CFG2, CYREG_TMR1_CFG2
.set PWM_2_PWMHW__CNT_CMP0, CYREG_TMR1_CNT_CMP0
.set PWM_2_PWMHW__CNT_CMP1, CYREG_TMR1_CNT_CMP1
.set PWM_2_PWMHW__PER0, CYREG_TMR1_PER0
.set PWM_2_PWMHW__PER1, CYREG_TMR1_PER1
.set PWM_2_PWMHW__PM_ACT_CFG, CYREG_PM_ACT_CFG3
.set PWM_2_PWMHW__PM_ACT_MSK, 0x02
.set PWM_2_PWMHW__PM_STBY_CFG, CYREG_PM_STBY_CFG3
.set PWM_2_PWMHW__PM_STBY_MSK, 0x02
.set PWM_2_PWMHW__RT0, CYREG_TMR1_RT0
.set PWM_2_PWMHW__RT1, CYREG_TMR1_RT1
.set PWM_2_PWMHW__SR0, CYREG_TMR1_SR0

/* SEN_1 */
.set SEN_1__0__INTTYPE, CYREG_PICU3_INTTYPE0
.set SEN_1__0__MASK, 0x01
.set SEN_1__0__PC, CYREG_PRT3_PC0
.set SEN_1__0__PORT, 3
.set SEN_1__0__SHIFT, 0
.set SEN_1__AG, CYREG_PRT3_AG
.set SEN_1__AMUX, CYREG_PRT3_AMUX
.set SEN_1__BIE, CYREG_PRT3_BIE
.set SEN_1__BIT_MASK, CYREG_PRT3_BIT_MASK
.set SEN_1__BYP, CYREG_PRT3_BYP
.set SEN_1__CTL, CYREG_PRT3_CTL
.set SEN_1__DM0, CYREG_PRT3_DM0
.set SEN_1__DM1, CYREG_PRT3_DM1
.set SEN_1__DM2, CYREG_PRT3_DM2
.set SEN_1__DR, CYREG_PRT3_DR
.set SEN_1__INP_DIS, CYREG_PRT3_INP_DIS
.set SEN_1__INTTYPE_BASE, CYDEV_PICU_INTTYPE_PICU3_BASE
.set SEN_1__LCD_COM_SEG, CYREG_PRT3_LCD_COM_SEG
.set SEN_1__LCD_EN, CYREG_PRT3_LCD_EN
.set SEN_1__MASK, 0x01
.set SEN_1__PORT, 3
.set SEN_1__PRT, CYREG_PRT3_PRT
.set SEN_1__PRTDSI__CAPS_SEL, CYREG_PRT3_CAPS_SEL
.set SEN_1__PRTDSI__DBL_SYNC_IN, CYREG_PRT3_DBL_SYNC_IN
.set SEN_1__PRTDSI__OE_SEL0, CYREG_PRT3_OE_SEL0
.set SEN_1__PRTDSI__OE_SEL1, CYREG_PRT3_OE_SEL1
.set SEN_1__PRTDSI__OUT_SEL0, CYREG_PRT3_OUT_SEL0
.set SEN_1__PRTDSI__OUT_SEL1, CYREG_PRT3_OUT_SEL1
.set SEN_1__PRTDSI__SYNC_OUT, CYREG_PRT3_SYNC_OUT
.set SEN_1__PS, CYREG_PRT3_PS
.set SEN_1__SHIFT, 0
.set SEN_1__SLW, CYREG_PRT3_SLW

/* SEN_2 */
.set SEN_2__0__INTTYPE, CYREG_PICU3_INTTYPE1
.set SEN_2__0__MASK, 0x02
.set SEN_2__0__PC, CYREG_PRT3_PC1
.set SEN_2__0__PORT, 3
.set SEN_2__0__SHIFT, 1
.set SEN_2__AG, CYREG_PRT3_AG
.set SEN_2__AMUX, CYREG_PRT3_AMUX
.set SEN_2__BIE, CYREG_PRT3_BIE
.set SEN_2__BIT_MASK, CYREG_PRT3_BIT_MASK
.set SEN_2__BYP, CYREG_PRT3_BYP
.set SEN_2__CTL, CYREG_PRT3_CTL
.set SEN_2__DM0, CYREG_PRT3_DM0
.set SEN_2__DM1, CYREG_PRT3_DM1
.set SEN_2__DM2, CYREG_PRT3_DM2
.set SEN_2__DR, CYREG_PRT3_DR
.set SEN_2__INP_DIS, CYREG_PRT3_INP_DIS
.set SEN_2__INTTYPE_BASE, CYDEV_PICU_INTTYPE_PICU3_BASE
.set SEN_2__LCD_COM_SEG, CYREG_PRT3_LCD_COM_SEG
.set SEN_2__LCD_EN, CYREG_PRT3_LCD_EN
.set SEN_2__MASK, 0x02
.set SEN_2__PORT, 3
.set SEN_2__PRT, CYREG_PRT3_PRT
.set SEN_2__PRTDSI__CAPS_SEL, CYREG_PRT3_CAPS_SEL
.set SEN_2__PRTDSI__DBL_SYNC_IN, CYREG_PRT3_DBL_SYNC_IN
.set SEN_2__PRTDSI__OE_SEL0, CYREG_PRT3_OE_SEL0
.set SEN_2__PRTDSI__OE_SEL1, CYREG_PRT3_OE_SEL1
.set SEN_2__PRTDSI__OUT_SEL0, CYREG_PRT3_OUT_SEL0
.set SEN_2__PRTDSI__OUT_SEL1, CYREG_PRT3_OUT_SEL1
.set SEN_2__PRTDSI__SYNC_OUT, CYREG_PRT3_SYNC_OUT
.set SEN_2__PS, CYREG_PRT3_PS
.set SEN_2__SHIFT, 1
.set SEN_2__SLW, CYREG_PRT3_SLW

/* SEN_3 */
.set SEN_3__0__INTTYPE, CYREG_PICU1_INTTYPE7
.set SEN_3__0__MASK, 0x80
.set SEN_3__0__PC, CYREG_PRT1_PC7
.set SEN_3__0__PORT, 1
.set SEN_3__0__SHIFT, 7
.set SEN_3__AG, CYREG_PRT1_AG
.set SEN_3__AMUX, CYREG_PRT1_AMUX
.set SEN_3__BIE, CYREG_PRT1_BIE
.set SEN_3__BIT_MASK, CYREG_PRT1_BIT_MASK
.set SEN_3__BYP, CYREG_PRT1_BYP
.set SEN_3__CTL, CYREG_PRT1_CTL
.set SEN_3__DM0, CYREG_PRT1_DM0
.set SEN_3__DM1, CYREG_PRT1_DM1
.set SEN_3__DM2, CYREG_PRT1_DM2
.set SEN_3__DR, CYREG_PRT1_DR
.set SEN_3__INP_DIS, CYREG_PRT1_INP_DIS
.set SEN_3__INTTYPE_BASE, CYDEV_PICU_INTTYPE_PICU1_BASE
.set SEN_3__LCD_COM_SEG, CYREG_PRT1_LCD_COM_SEG
.set SEN_3__LCD_EN, CYREG_PRT1_LCD_EN
.set SEN_3__MASK, 0x80
.set SEN_3__PORT, 1
.set SEN_3__PRT, CYREG_PRT1_PRT
.set SEN_3__PRTDSI__CAPS_SEL, CYREG_PRT1_CAPS_SEL
.set SEN_3__PRTDSI__DBL_SYNC_IN, CYREG_PRT1_DBL_SYNC_IN
.set SEN_3__PRTDSI__OE_SEL0, CYREG_PRT1_OE_SEL0
.set SEN_3__PRTDSI__OE_SEL1, CYREG_PRT1_OE_SEL1
.set SEN_3__PRTDSI__OUT_SEL0, CYREG_PRT1_OUT_SEL0
.set SEN_3__PRTDSI__OUT_SEL1, CYREG_PRT1_OUT_SEL1
.set SEN_3__PRTDSI__SYNC_OUT, CYREG_PRT1_SYNC_OUT
.set SEN_3__PS, CYREG_PRT1_PS
.set SEN_3__SHIFT, 7
.set SEN_3__SLW, CYREG_PRT1_SLW

/* SEN_4 */
.set SEN_4__0__INTTYPE, CYREG_PICU0_INTTYPE3
.set SEN_4__0__MASK, 0x08
.set SEN_4__0__PC, CYREG_PRT0_PC3
.set SEN_4__0__PORT, 0
.set SEN_4__0__SHIFT, 3
.set SEN_4__AG, CYREG_PRT0_AG
.set SEN_4__AMUX, CYREG_PRT0_AMUX
.set SEN_4__BIE, CYREG_PRT0_BIE
.set SEN_4__BIT_MASK, CYREG_PRT0_BIT_MASK
.set SEN_4__BYP, CYREG_PRT0_BYP
.set SEN_4__CTL, CYREG_PRT0_CTL
.set SEN_4__DM0, CYREG_PRT0_DM0
.set SEN_4__DM1, CYREG_PRT0_DM1
.set SEN_4__DM2, CYREG_PRT0_DM2
.set SEN_4__DR, CYREG_PRT0_DR
.set SEN_4__INP_DIS, CYREG_PRT0_INP_DIS
.set SEN_4__INTTYPE_BASE, CYDEV_PICU_INTTYPE_PICU0_BASE
.set SEN_4__LCD_COM_SEG, CYREG_PRT0_LCD_COM_SEG
.set SEN_4__LCD_EN, CYREG_PRT0_LCD_EN
.set SEN_4__MASK, 0x08
.set SEN_4__PORT, 0
.set SEN_4__PRT, CYREG_PRT0_PRT
.set SEN_4__PRTDSI__CAPS_SEL, CYREG_PRT0_CAPS_SEL
.set SEN_4__PRTDSI__DBL_SYNC_IN, CYREG_PRT0_DBL_SYNC_IN
.set SEN_4__PRTDSI__OE_SEL0, CYREG_PRT0_OE_SEL0
.set SEN_4__PRTDSI__OE_SEL1, CYREG_PRT0_OE_SEL1
.set SEN_4__PRTDSI__OUT_SEL0, CYREG_PRT0_OUT_SEL0
.set SEN_4__PRTDSI__OUT_SEL1, CYREG_PRT0_OUT_SEL1
.set SEN_4__PRTDSI__SYNC_OUT, CYREG_PRT0_SYNC_OUT
.set SEN_4__PS, CYREG_PRT0_PS
.set SEN_4__SHIFT, 3
.set SEN_4__SLW, CYREG_PRT0_SLW

/* SEN_5 */
.set SEN_5__0__INTTYPE, CYREG_PICU2_INTTYPE7
.set SEN_5__0__MASK, 0x80
.set SEN_5__0__PC, CYREG_PRT2_PC7
.set SEN_5__0__PORT, 2
.set SEN_5__0__SHIFT, 7
.set SEN_5__AG, CYREG_PRT2_AG
.set SEN_5__AMUX, CYREG_PRT2_AMUX
.set SEN_5__BIE, CYREG_PRT2_BIE
.set SEN_5__BIT_MASK, CYREG_PRT2_BIT_MASK
.set SEN_5__BYP, CYREG_PRT2_BYP
.set SEN_5__CTL, CYREG_PRT2_CTL
.set SEN_5__DM0, CYREG_PRT2_DM0
.set SEN_5__DM1, CYREG_PRT2_DM1
.set SEN_5__DM2, CYREG_PRT2_DM2
.set SEN_5__DR, CYREG_PRT2_DR
.set SEN_5__INP_DIS, CYREG_PRT2_INP_DIS
.set SEN_5__INTTYPE_BASE, CYDEV_PICU_INTTYPE_PICU2_BASE
.set SEN_5__LCD_COM_SEG, CYREG_PRT2_LCD_COM_SEG
.set SEN_5__LCD_EN, CYREG_PRT2_LCD_EN
.set SEN_5__MASK, 0x80
.set SEN_5__PORT, 2
.set SEN_5__PRT, CYREG_PRT2_PRT
.set SEN_5__PRTDSI__CAPS_SEL, CYREG_PRT2_CAPS_SEL
.set SEN_5__PRTDSI__DBL_SYNC_IN, CYREG_PRT2_DBL_SYNC_IN
.set SEN_5__PRTDSI__OE_SEL0, CYREG_PRT2_OE_SEL0
.set SEN_5__PRTDSI__OE_SEL1, CYREG_PRT2_OE_SEL1
.set SEN_5__PRTDSI__OUT_SEL0, CYREG_PRT2_OUT_SEL0
.set SEN_5__PRTDSI__OUT_SEL1, CYREG_PRT2_OUT_SEL1
.set SEN_5__PRTDSI__SYNC_OUT, CYREG_PRT2_SYNC_OUT
.set SEN_5__PS, CYREG_PRT2_PS
.set SEN_5__SHIFT, 7
.set SEN_5__SLW, CYREG_PRT2_SLW

/* SEN_6 */
.set SEN_6__0__INTTYPE, CYREG_PICU1_INTTYPE6
.set SEN_6__0__MASK, 0x40
.set SEN_6__0__PC, CYREG_PRT1_PC6
.set SEN_6__0__PORT, 1
.set SEN_6__0__SHIFT, 6
.set SEN_6__AG, CYREG_PRT1_AG
.set SEN_6__AMUX, CYREG_PRT1_AMUX
.set SEN_6__BIE, CYREG_PRT1_BIE
.set SEN_6__BIT_MASK, CYREG_PRT1_BIT_MASK
.set SEN_6__BYP, CYREG_PRT1_BYP
.set SEN_6__CTL, CYREG_PRT1_CTL
.set SEN_6__DM0, CYREG_PRT1_DM0
.set SEN_6__DM1, CYREG_PRT1_DM1
.set SEN_6__DM2, CYREG_PRT1_DM2
.set SEN_6__DR, CYREG_PRT1_DR
.set SEN_6__INP_DIS, CYREG_PRT1_INP_DIS
.set SEN_6__INTTYPE_BASE, CYDEV_PICU_INTTYPE_PICU1_BASE
.set SEN_6__LCD_COM_SEG, CYREG_PRT1_LCD_COM_SEG
.set SEN_6__LCD_EN, CYREG_PRT1_LCD_EN
.set SEN_6__MASK, 0x40
.set SEN_6__PORT, 1
.set SEN_6__PRT, CYREG_PRT1_PRT
.set SEN_6__PRTDSI__CAPS_SEL, CYREG_PRT1_CAPS_SEL
.set SEN_6__PRTDSI__DBL_SYNC_IN, CYREG_PRT1_DBL_SYNC_IN
.set SEN_6__PRTDSI__OE_SEL0, CYREG_PRT1_OE_SEL0
.set SEN_6__PRTDSI__OE_SEL1, CYREG_PRT1_OE_SEL1
.set SEN_6__PRTDSI__OUT_SEL0, CYREG_PRT1_OUT_SEL0
.set SEN_6__PRTDSI__OUT_SEL1, CYREG_PRT1_OUT_SEL1
.set SEN_6__PRTDSI__SYNC_OUT, CYREG_PRT1_SYNC_OUT
.set SEN_6__PS, CYREG_PRT1_PS
.set SEN_6__SHIFT, 6
.set SEN_6__SLW, CYREG_PRT1_SLW

/* SEN_7 */
.set SEN_7__0__INTTYPE, CYREG_PICU0_INTTYPE7
.set SEN_7__0__MASK, 0x80
.set SEN_7__0__PC, CYREG_PRT0_PC7
.set SEN_7__0__PORT, 0
.set SEN_7__0__SHIFT, 7
.set SEN_7__AG, CYREG_PRT0_AG
.set SEN_7__AMUX, CYREG_PRT0_AMUX
.set SEN_7__BIE, CYREG_PRT0_BIE
.set SEN_7__BIT_MASK, CYREG_PRT0_BIT_MASK
.set SEN_7__BYP, CYREG_PRT0_BYP
.set SEN_7__CTL, CYREG_PRT0_CTL
.set SEN_7__DM0, CYREG_PRT0_DM0
.set SEN_7__DM1, CYREG_PRT0_DM1
.set SEN_7__DM2, CYREG_PRT0_DM2
.set SEN_7__DR, CYREG_PRT0_DR
.set SEN_7__INP_DIS, CYREG_PRT0_INP_DIS
.set SEN_7__INTTYPE_BASE, CYDEV_PICU_INTTYPE_PICU0_BASE
.set SEN_7__LCD_COM_SEG, CYREG_PRT0_LCD_COM_SEG
.set SEN_7__LCD_EN, CYREG_PRT0_LCD_EN
.set SEN_7__MASK, 0x80
.set SEN_7__PORT, 0
.set SEN_7__PRT, CYREG_PRT0_PRT
.set SEN_7__PRTDSI__CAPS_SEL, CYREG_PRT0_CAPS_SEL
.set SEN_7__PRTDSI__DBL_SYNC_IN, CYREG_PRT0_DBL_SYNC_IN
.set SEN_7__PRTDSI__OE_SEL0, CYREG_PRT0_OE_SEL0
.set SEN_7__PRTDSI__OE_SEL1, CYREG_PRT0_OE_SEL1
.set SEN_7__PRTDSI__OUT_SEL0, CYREG_PRT0_OUT_SEL0
.set SEN_7__PRTDSI__OUT_SEL1, CYREG_PRT0_OUT_SEL1
.set SEN_7__PRTDSI__SYNC_OUT, CYREG_PRT0_SYNC_OUT
.set SEN_7__PS, CYREG_PRT0_PS
.set SEN_7__SHIFT, 7
.set SEN_7__SLW, CYREG_PRT0_SLW

/* M1_IN1 */
.set M1_IN1__0__INTTYPE, CYREG_PICU3_INTTYPE4
.set M1_IN1__0__MASK, 0x10
.set M1_IN1__0__PC, CYREG_PRT3_PC4
.set M1_IN1__0__PORT, 3
.set M1_IN1__0__SHIFT, 4
.set M1_IN1__AG, CYREG_PRT3_AG
.set M1_IN1__AMUX, CYREG_PRT3_AMUX
.set M1_IN1__BIE, CYREG_PRT3_BIE
.set M1_IN1__BIT_MASK, CYREG_PRT3_BIT_MASK
.set M1_IN1__BYP, CYREG_PRT3_BYP
.set M1_IN1__CTL, CYREG_PRT3_CTL
.set M1_IN1__DM0, CYREG_PRT3_DM0
.set M1_IN1__DM1, CYREG_PRT3_DM1
.set M1_IN1__DM2, CYREG_PRT3_DM2
.set M1_IN1__DR, CYREG_PRT3_DR
.set M1_IN1__INP_DIS, CYREG_PRT3_INP_DIS
.set M1_IN1__INTTYPE_BASE, CYDEV_PICU_INTTYPE_PICU3_BASE
.set M1_IN1__LCD_COM_SEG, CYREG_PRT3_LCD_COM_SEG
.set M1_IN1__LCD_EN, CYREG_PRT3_LCD_EN
.set M1_IN1__MASK, 0x10
.set M1_IN1__PORT, 3
.set M1_IN1__PRT, CYREG_PRT3_PRT
.set M1_IN1__PRTDSI__CAPS_SEL, CYREG_PRT3_CAPS_SEL
.set M1_IN1__PRTDSI__DBL_SYNC_IN, CYREG_PRT3_DBL_SYNC_IN
.set M1_IN1__PRTDSI__OE_SEL0, CYREG_PRT3_OE_SEL0
.set M1_IN1__PRTDSI__OE_SEL1, CYREG_PRT3_OE_SEL1
.set M1_IN1__PRTDSI__OUT_SEL0, CYREG_PRT3_OUT_SEL0
.set M1_IN1__PRTDSI__OUT_SEL1, CYREG_PRT3_OUT_SEL1
.set M1_IN1__PRTDSI__SYNC_OUT, CYREG_PRT3_SYNC_OUT
.set M1_IN1__PS, CYREG_PRT3_PS
.set M1_IN1__SHIFT, 4
.set M1_IN1__SLW, CYREG_PRT3_SLW

/* M1_IN2 */
.set M1_IN2__0__INTTYPE, CYREG_PICU3_INTTYPE5
.set M1_IN2__0__MASK, 0x20
.set M1_IN2__0__PC, CYREG_PRT3_PC5
.set M1_IN2__0__PORT, 3
.set M1_IN2__0__SHIFT, 5
.set M1_IN2__AG, CYREG_PRT3_AG
.set M1_IN2__AMUX, CYREG_PRT3_AMUX
.set M1_IN2__BIE, CYREG_PRT3_BIE
.set M1_IN2__BIT_MASK, CYREG_PRT3_BIT_MASK
.set M1_IN2__BYP, CYREG_PRT3_BYP
.set M1_IN2__CTL, CYREG_PRT3_CTL
.set M1_IN2__DM0, CYREG_PRT3_DM0
.set M1_IN2__DM1, CYREG_PRT3_DM1
.set M1_IN2__DM2, CYREG_PRT3_DM2
.set M1_IN2__DR, CYREG_PRT3_DR
.set M1_IN2__INP_DIS, CYREG_PRT3_INP_DIS
.set M1_IN2__INTTYPE_BASE, CYDEV_PICU_INTTYPE_PICU3_BASE
.set M1_IN2__LCD_COM_SEG, CYREG_PRT3_LCD_COM_SEG
.set M1_IN2__LCD_EN, CYREG_PRT3_LCD_EN
.set M1_IN2__MASK, 0x20
.set M1_IN2__PORT, 3
.set M1_IN2__PRT, CYREG_PRT3_PRT
.set M1_IN2__PRTDSI__CAPS_SEL, CYREG_PRT3_CAPS_SEL
.set M1_IN2__PRTDSI__DBL_SYNC_IN, CYREG_PRT3_DBL_SYNC_IN
.set M1_IN2__PRTDSI__OE_SEL0, CYREG_PRT3_OE_SEL0
.set M1_IN2__PRTDSI__OE_SEL1, CYREG_PRT3_OE_SEL1
.set M1_IN2__PRTDSI__OUT_SEL0, CYREG_PRT3_OUT_SEL0
.set M1_IN2__PRTDSI__OUT_SEL1, CYREG_PRT3_OUT_SEL1
.set M1_IN2__PRTDSI__SYNC_OUT, CYREG_PRT3_SYNC_OUT
.set M1_IN2__PS, CYREG_PRT3_PS
.set M1_IN2__SHIFT, 5
.set M1_IN2__SLW, CYREG_PRT3_SLW

/* M1_INV */
.set M1_INV__0__INTTYPE, CYREG_PICU3_INTTYPE7
.set M1_INV__0__MASK, 0x80
.set M1_INV__0__PC, CYREG_PRT3_PC7
.set M1_INV__0__PORT, 3
.set M1_INV__0__SHIFT, 7
.set M1_INV__AG, CYREG_PRT3_AG
.set M1_INV__AMUX, CYREG_PRT3_AMUX
.set M1_INV__BIE, CYREG_PRT3_BIE
.set M1_INV__BIT_MASK, CYREG_PRT3_BIT_MASK
.set M1_INV__BYP, CYREG_PRT3_BYP
.set M1_INV__CTL, CYREG_PRT3_CTL
.set M1_INV__DM0, CYREG_PRT3_DM0
.set M1_INV__DM1, CYREG_PRT3_DM1
.set M1_INV__DM2, CYREG_PRT3_DM2
.set M1_INV__DR, CYREG_PRT3_DR
.set M1_INV__INP_DIS, CYREG_PRT3_INP_DIS
.set M1_INV__INTTYPE_BASE, CYDEV_PICU_INTTYPE_PICU3_BASE
.set M1_INV__LCD_COM_SEG, CYREG_PRT3_LCD_COM_SEG
.set M1_INV__LCD_EN, CYREG_PRT3_LCD_EN
.set M1_INV__MASK, 0x80
.set M1_INV__PORT, 3
.set M1_INV__PRT, CYREG_PRT3_PRT
.set M1_INV__PRTDSI__CAPS_SEL, CYREG_PRT3_CAPS_SEL
.set M1_INV__PRTDSI__DBL_SYNC_IN, CYREG_PRT3_DBL_SYNC_IN
.set M1_INV__PRTDSI__OE_SEL0, CYREG_PRT3_OE_SEL0
.set M1_INV__PRTDSI__OE_SEL1, CYREG_PRT3_OE_SEL1
.set M1_INV__PRTDSI__OUT_SEL0, CYREG_PRT3_OUT_SEL0
.set M1_INV__PRTDSI__OUT_SEL1, CYREG_PRT3_OUT_SEL1
.set M1_INV__PRTDSI__SYNC_OUT, CYREG_PRT3_SYNC_OUT
.set M1_INV__PS, CYREG_PRT3_PS
.set M1_INV__SHIFT, 7
.set M1_INV__SLW, CYREG_PRT3_SLW

/* M2_IN1 */
.set M2_IN1__0__INTTYPE, CYREG_PICU1_INTTYPE4
.set M2_IN1__0__MASK, 0x10
.set M2_IN1__0__PC, CYREG_PRT1_PC4
.set M2_IN1__0__PORT, 1
.set M2_IN1__0__SHIFT, 4
.set M2_IN1__AG, CYREG_PRT1_AG
.set M2_IN1__AMUX, CYREG_PRT1_AMUX
.set M2_IN1__BIE, CYREG_PRT1_BIE
.set M2_IN1__BIT_MASK, CYREG_PRT1_BIT_MASK
.set M2_IN1__BYP, CYREG_PRT1_BYP
.set M2_IN1__CTL, CYREG_PRT1_CTL
.set M2_IN1__DM0, CYREG_PRT1_DM0
.set M2_IN1__DM1, CYREG_PRT1_DM1
.set M2_IN1__DM2, CYREG_PRT1_DM2
.set M2_IN1__DR, CYREG_PRT1_DR
.set M2_IN1__INP_DIS, CYREG_PRT1_INP_DIS
.set M2_IN1__INTTYPE_BASE, CYDEV_PICU_INTTYPE_PICU1_BASE
.set M2_IN1__LCD_COM_SEG, CYREG_PRT1_LCD_COM_SEG
.set M2_IN1__LCD_EN, CYREG_PRT1_LCD_EN
.set M2_IN1__MASK, 0x10
.set M2_IN1__PORT, 1
.set M2_IN1__PRT, CYREG_PRT1_PRT
.set M2_IN1__PRTDSI__CAPS_SEL, CYREG_PRT1_CAPS_SEL
.set M2_IN1__PRTDSI__DBL_SYNC_IN, CYREG_PRT1_DBL_SYNC_IN
.set M2_IN1__PRTDSI__OE_SEL0, CYREG_PRT1_OE_SEL0
.set M2_IN1__PRTDSI__OE_SEL1, CYREG_PRT1_OE_SEL1
.set M2_IN1__PRTDSI__OUT_SEL0, CYREG_PRT1_OUT_SEL0
.set M2_IN1__PRTDSI__OUT_SEL1, CYREG_PRT1_OUT_SEL1
.set M2_IN1__PRTDSI__SYNC_OUT, CYREG_PRT1_SYNC_OUT
.set M2_IN1__PS, CYREG_PRT1_PS
.set M2_IN1__SHIFT, 4
.set M2_IN1__SLW, CYREG_PRT1_SLW

/* M2_IN2 */
.set M2_IN2__0__INTTYPE, CYREG_PICU1_INTTYPE5
.set M2_IN2__0__MASK, 0x20
.set M2_IN2__0__PC, CYREG_PRT1_PC5
.set M2_IN2__0__PORT, 1
.set M2_IN2__0__SHIFT, 5
.set M2_IN2__AG, CYREG_PRT1_AG
.set M2_IN2__AMUX, CYREG_PRT1_AMUX
.set M2_IN2__BIE, CYREG_PRT1_BIE
.set M2_IN2__BIT_MASK, CYREG_PRT1_BIT_MASK
.set M2_IN2__BYP, CYREG_PRT1_BYP
.set M2_IN2__CTL, CYREG_PRT1_CTL
.set M2_IN2__DM0, CYREG_PRT1_DM0
.set M2_IN2__DM1, CYREG_PRT1_DM1
.set M2_IN2__DM2, CYREG_PRT1_DM2
.set M2_IN2__DR, CYREG_PRT1_DR
.set M2_IN2__INP_DIS, CYREG_PRT1_INP_DIS
.set M2_IN2__INTTYPE_BASE, CYDEV_PICU_INTTYPE_PICU1_BASE
.set M2_IN2__LCD_COM_SEG, CYREG_PRT1_LCD_COM_SEG
.set M2_IN2__LCD_EN, CYREG_PRT1_LCD_EN
.set M2_IN2__MASK, 0x20
.set M2_IN2__PORT, 1
.set M2_IN2__PRT, CYREG_PRT1_PRT
.set M2_IN2__PRTDSI__CAPS_SEL, CYREG_PRT1_CAPS_SEL
.set M2_IN2__PRTDSI__DBL_SYNC_IN, CYREG_PRT1_DBL_SYNC_IN
.set M2_IN2__PRTDSI__OE_SEL0, CYREG_PRT1_OE_SEL0
.set M2_IN2__PRTDSI__OE_SEL1, CYREG_PRT1_OE_SEL1
.set M2_IN2__PRTDSI__OUT_SEL0, CYREG_PRT1_OUT_SEL0
.set M2_IN2__PRTDSI__OUT_SEL1, CYREG_PRT1_OUT_SEL1
.set M2_IN2__PRTDSI__SYNC_OUT, CYREG_PRT1_SYNC_OUT
.set M2_IN2__PS, CYREG_PRT1_PS
.set M2_IN2__SHIFT, 5
.set M2_IN2__SLW, CYREG_PRT1_SLW

/* M2_INV */
.set M2_INV__0__INTTYPE, CYREG_PICU1_INTTYPE3
.set M2_INV__0__MASK, 0x08
.set M2_INV__0__PC, CYREG_PRT1_PC3
.set M2_INV__0__PORT, 1
.set M2_INV__0__SHIFT, 3
.set M2_INV__AG, CYREG_PRT1_AG
.set M2_INV__AMUX, CYREG_PRT1_AMUX
.set M2_INV__BIE, CYREG_PRT1_BIE
.set M2_INV__BIT_MASK, CYREG_PRT1_BIT_MASK
.set M2_INV__BYP, CYREG_PRT1_BYP
.set M2_INV__CTL, CYREG_PRT1_CTL
.set M2_INV__DM0, CYREG_PRT1_DM0
.set M2_INV__DM1, CYREG_PRT1_DM1
.set M2_INV__DM2, CYREG_PRT1_DM2
.set M2_INV__DR, CYREG_PRT1_DR
.set M2_INV__INP_DIS, CYREG_PRT1_INP_DIS
.set M2_INV__INTTYPE_BASE, CYDEV_PICU_INTTYPE_PICU1_BASE
.set M2_INV__LCD_COM_SEG, CYREG_PRT1_LCD_COM_SEG
.set M2_INV__LCD_EN, CYREG_PRT1_LCD_EN
.set M2_INV__MASK, 0x08
.set M2_INV__PORT, 1
.set M2_INV__PRT, CYREG_PRT1_PRT
.set M2_INV__PRTDSI__CAPS_SEL, CYREG_PRT1_CAPS_SEL
.set M2_INV__PRTDSI__DBL_SYNC_IN, CYREG_PRT1_DBL_SYNC_IN
.set M2_INV__PRTDSI__OE_SEL0, CYREG_PRT1_OE_SEL0
.set M2_INV__PRTDSI__OE_SEL1, CYREG_PRT1_OE_SEL1
.set M2_INV__PRTDSI__OUT_SEL0, CYREG_PRT1_OUT_SEL0
.set M2_INV__PRTDSI__OUT_SEL1, CYREG_PRT1_OUT_SEL1
.set M2_INV__PRTDSI__SYNC_OUT, CYREG_PRT1_SYNC_OUT
.set M2_INV__PS, CYREG_PRT1_PS
.set M2_INV__SHIFT, 3
.set M2_INV__SLW, CYREG_PRT1_SLW

/* Clock_PWM */
.set Clock_PWM__CFG0, CYREG_CLKDIST_DCFG0_CFG0
.set Clock_PWM__CFG1, CYREG_CLKDIST_DCFG0_CFG1
.set Clock_PWM__CFG2, CYREG_CLKDIST_DCFG0_CFG2
.set Clock_PWM__CFG2_SRC_SEL_MASK, 0x07
.set Clock_PWM__INDEX, 0x00
.set Clock_PWM__PM_ACT_CFG, CYREG_PM_ACT_CFG2
.set Clock_PWM__PM_ACT_MSK, 0x01
.set Clock_PWM__PM_STBY_CFG, CYREG_PM_STBY_CFG2
.set Clock_PWM__PM_STBY_MSK, 0x01

/* Miscellaneous */
.set BCLK__BUS_CLK__HZ, 60000000
.set BCLK__BUS_CLK__KHZ, 60000
.set BCLK__BUS_CLK__MHZ, 60
.set CYDEV_CHIP_DIE_LEOPARD, 1
.set CYDEV_CHIP_DIE_PSOC4A, 18
.set CYDEV_CHIP_DIE_PSOC5LP, 2
.set CYDEV_CHIP_DIE_PSOC5TM, 3
.set CYDEV_CHIP_DIE_TMA4, 4
.set CYDEV_CHIP_DIE_UNKNOWN, 0
.set CYDEV_CHIP_FAMILY_FM0P, 5
.set CYDEV_CHIP_FAMILY_FM3, 6
.set CYDEV_CHIP_FAMILY_FM4, 7
.set CYDEV_CHIP_FAMILY_PSOC3, 1
.set CYDEV_CHIP_FAMILY_PSOC4, 2
.set CYDEV_CHIP_FAMILY_PSOC5, 3
.set CYDEV_CHIP_FAMILY_PSOC6, 4
.set CYDEV_CHIP_FAMILY_UNKNOWN, 0
.set CYDEV_CHIP_FAMILY_USED, CYDEV_CHIP_FAMILY_PSOC5
.set CYDEV_CHIP_JTAG_ID, 0x2E161069
.set CYDEV_CHIP_MEMBER_3A, 1
.set CYDEV_CHIP_MEMBER_4A, 18
.set CYDEV_CHIP_MEMBER_4D, 13
.set CYDEV_CHIP_MEMBER_4E, 6
.set CYDEV_CHIP_MEMBER_4F, 19
.set CYDEV_CHIP_MEMBER_4G, 4
.set CYDEV_CHIP_MEMBER_4H, 17
.set CYDEV_CHIP_MEMBER_4I, 23
.set CYDEV_CHIP_MEMBER_4J, 14
.set CYDEV_CHIP_MEMBER_4K, 15
.set CYDEV_CHIP_MEMBER_4L, 22
.set CYDEV_CHIP_MEMBER_4M, 21
.set CYDEV_CHIP_MEMBER_4N, 10
.set CYDEV_CHIP_MEMBER_4O, 7
.set CYDEV_CHIP_MEMBER_4P, 20
.set CYDEV_CHIP_MEMBER_4Q, 12
.set CYDEV_CHIP_MEMBER_4R, 8
.set CYDEV_CHIP_MEMBER_4S, 11
.set CYDEV_CHIP_MEMBER_4T, 9
.set CYDEV_CHIP_MEMBER_4U, 5
.set CYDEV_CHIP_MEMBER_4V, 16
.set CYDEV_CHIP_MEMBER_5A, 3
.set CYDEV_CHIP_MEMBER_5B, 2
.set CYDEV_CHIP_MEMBER_6A, 24
.set CYDEV_CHIP_MEMBER_FM3, 28
.set CYDEV_CHIP_MEMBER_FM4, 29
.set CYDEV_CHIP_MEMBER_PDL_FM0P_TYPE1, 25
.set CYDEV_CHIP_MEMBER_PDL_FM0P_TYPE2, 26
.set CYDEV_CHIP_MEMBER_PDL_FM0P_TYPE3, 27
.set CYDEV_CHIP_MEMBER_UNKNOWN, 0
.set CYDEV_CHIP_MEMBER_USED, CYDEV_CHIP_MEMBER_5B
.set CYDEV_CHIP_DIE_EXPECT, CYDEV_CHIP_MEMBER_USED
.set CYDEV_CHIP_DIE_ACTUAL, CYDEV_CHIP_DIE_EXPECT
.set CYDEV_CHIP_REV_LEOPARD_ES1, 0
.set CYDEV_CHIP_REV_LEOPARD_ES2, 1
.set CYDEV_CHIP_REV_LEOPARD_ES3, 3
.set CYDEV_CHIP_REV_LEOPARD_PRODUCTION, 3
.set CYDEV_CHIP_REV_PSOC4A_ES0, 17
.set CYDEV_CHIP_REV_PSOC4A_PRODUCTION, 17
.set CYDEV_CHIP_REV_PSOC5LP_ES0, 0
.set CYDEV_CHIP_REV_PSOC5LP_PRODUCTION, 0
.set CYDEV_CHIP_REV_PSOC5TM_ES0, 0
.set CYDEV_CHIP_REV_PSOC5TM_ES1, 1
.set CYDEV_CHIP_REV_PSOC5TM_PRODUCTION, 1
.set CYDEV_CHIP_REV_TMA4_ES, 17
.set CYDEV_CHIP_REV_TMA4_ES2, 33
.set CYDEV_CHIP_REV_TMA4_PRODUCTION, 17
.set CYDEV_CHIP_REVISION_3A_ES1, 0
.set CYDEV_CHIP_REVISION_3A_ES2, 1
.set CYDEV_CHIP_REVISION_3A_ES3, 3
.set CYDEV_CHIP_REVISION_3A_PRODUCTION, 3
.set CYDEV_CHIP_REVISION_4A_ES0, 17
.set CYDEV_CHIP_REVISION_4A_PRODUCTION, 17
.set CYDEV_CHIP_REVISION_4D_PRODUCTION, 0
.set CYDEV_CHIP_REVISION_4E_CCG2_NO_USBPD, 0
.set CYDEV_CHIP_REVISION_4E_PRODUCTION, 0
.set CYDEV_CHIP_REVISION_4F_PRODUCTION, 0
.set CYDEV_CHIP_REVISION_4F_PRODUCTION_256DMA, 0
.set CYDEV_CHIP_REVISION_4F_PRODUCTION_256K, 0
.set CYDEV_CHIP_REVISION_4G_ES, 17
.set CYDEV_CHIP_REVISION_4G_ES2, 33
.set CYDEV_CHIP_REVISION_4G_PRODUCTION, 17
.set CYDEV_CHIP_REVISION_4H_PRODUCTION, 0
.set CYDEV_CHIP_REVISION_4I_PRODUCTION, 0
.set CYDEV_CHIP_REVISION_4J_PRODUCTION, 0
.set CYDEV_CHIP_REVISION_4K_PRODUCTION, 0
.set CYDEV_CHIP_REVISION_4L_PRODUCTION, 0
.set CYDEV_CHIP_REVISION_4M_PRODUCTION, 0
.set CYDEV_CHIP_REVISION_4N_PRODUCTION, 0
.set CYDEV_CHIP_REVISION_4O_PRODUCTION, 0
.set CYDEV_CHIP_REVISION_4P_PRODUCTION, 0
.set CYDEV_CHIP_REVISION_4Q_PRODUCTION, 0
.set CYDEV_CHIP_REVISION_4R_PRODUCTION, 0
.set CYDEV_CHIP_REVISION_4S_PRODUCTION, 0
.set CYDEV_CHIP_REVISION_4T_PRODUCTION, 0
.set CYDEV_CHIP_REVISION_4U_PRODUCTION, 0
.set CYDEV_CHIP_REVISION_4V_PRODUCTION, 0
.set CYDEV_CHIP_REVISION_5A_ES0, 0
.set CYDEV_CHIP_REVISION_5A_ES1, 1
.set CYDEV_CHIP_REVISION_5A_PRODUCTION, 1
.set CYDEV_CHIP_REVISION_5B_ES0, 0
.set CYDEV_CHIP_REVISION_5B_PRODUCTION, 0
.set CYDEV_CHIP_REVISION_6A_ES, 17
.set CYDEV_CHIP_REVISION_6A_NO_UDB, 33
.set CYDEV_CHIP_REVISION_6A_PRODUCTION, 33
.set CYDEV_CHIP_REVISION_FM3_PRODUCTION, 0
.set CYDEV_CHIP_REVISION_FM4_PRODUCTION, 0
.set CYDEV_CHIP_REVISION_PDL_FM0P_TYPE1_PRODUCTION, 0
.set CYDEV_CHIP_REVISION_PDL_FM0P_TYPE2_PRODUCTION, 0
.set CYDEV_CHIP_REVISION_PDL_FM0P_TYPE3_PRODUCTION, 0
.set CYDEV_CHIP_REVISION_USED, CYDEV_CHIP_REVISION_5B_PRODUCTION
.set CYDEV_CHIP_REV_EXPECT, CYDEV_CHIP_REVISION_USED
.set CYDEV_CONFIG_FASTBOOT_ENABLED, 1
.set CYDEV_CONFIG_UNUSED_IO_AllowButWarn, 0
.set CYDEV_CONFIG_UNUSED_IO, CYDEV_CONFIG_UNUSED_IO_AllowButWarn
.set CYDEV_CONFIG_UNUSED_IO_AllowWithInfo, 1
.set CYDEV_CONFIG_UNUSED_IO_Disallowed, 2
.set CYDEV_CONFIGURATION_COMPRESSED, 1
.set CYDEV_CONFIGURATION_DMA, 0
.set CYDEV_CONFIGURATION_ECC, 1
.set CYDEV_CONFIGURATION_IMOENABLED, CYDEV_CONFIG_FASTBOOT_ENABLED
.set CYDEV_CONFIGURATION_MODE_COMPRESSED, 0
.set CYDEV_CONFIGURATION_MODE, CYDEV_CONFIGURATION_MODE_COMPRESSED
.set CYDEV_CONFIGURATION_MODE_DMA, 2
.set CYDEV_CONFIGURATION_MODE_UNCOMPRESSED, 1
.set CYDEV_DEBUG_ENABLE_MASK, 0x20
.set CYDEV_DEBUG_ENABLE_REGISTER, CYREG_MLOGIC_DEBUG
.set CYDEV_DEBUGGING_DPS_Disable, 3
.set CYDEV_DEBUGGING_DPS, CYDEV_DEBUGGING_DPS_Disable
.set CYDEV_DEBUGGING_DPS_JTAG_4, 1
.set CYDEV_DEBUGGING_DPS_JTAG_5, 0
.set CYDEV_DEBUGGING_DPS_SWD, 2
.set CYDEV_DEBUGGING_DPS_SWD_SWV, 6
.set CYDEV_DEBUGGING_ENABLE, 0
.set CYDEV_DEBUGGING_XRES, 0
.set CYDEV_DMA_CHANNELS_AVAILABLE, 24
.set CYDEV_ECC_ENABLE, 0
.set CYDEV_HEAP_SIZE, 0x80
.set CYDEV_INSTRUCT_CACHE_ENABLED, 1
.set CYDEV_INTR_RISING, 0x00000000
.set CYDEV_IS_EXPORTING_CODE, 0
.set CYDEV_IS_IMPORTING_CODE, 0
.set CYDEV_PROJ_TYPE, 0
.set CYDEV_PROJ_TYPE_BOOTLOADER, 1
.set CYDEV_PROJ_TYPE_LAUNCHER, 5
.set CYDEV_PROJ_TYPE_LOADABLE, 2
.set CYDEV_PROJ_TYPE_LOADABLEANDBOOTLOADER, 4
.set CYDEV_PROJ_TYPE_MULTIAPPBOOTLOADER, 3
.set CYDEV_PROJ_TYPE_STANDARD, 0
.set CYDEV_PROTECTION_ENABLE, 1
.set CYDEV_STACK_SIZE, 0x0800
.set CYDEV_USB_CLK_OSC_LOCKING_ENABLED_AT_PWR_UP, 1
.set CYDEV_USE_BUNDLED_CMSIS, 1
.set CYDEV_VARIABLE_VDDA, 0
.set CYDEV_VDDA_MV, 5000
.set CYDEV_VDDD_MV, 5000
.set CYDEV_VDDIO0_MV, 5000
.set CYDEV_VDDIO1_MV, 5000
.set CYDEV_VDDIO2_MV, 5000
.set CYDEV_VDDIO3_MV, 5000
.set CYDEV_VIO0_MV, 5000
.set CYDEV_VIO1_MV, 5000
.set CYDEV_VIO2_MV, 5000
.set CYDEV_VIO3_MV, 5000
.set CYIPBLOCK_ARM_CM3_VERSION, 0
.set CYIPBLOCK_P3_ANAIF_VERSION, 0
.set CYIPBLOCK_P3_CAN_VERSION, 0
.set CYIPBLOCK_P3_CAPSENSE_VERSION, 0
.set CYIPBLOCK_P3_COMP_VERSION, 0
.set CYIPBLOCK_P3_DECIMATOR_VERSION, 0
.set CYIPBLOCK_P3_DFB_VERSION, 0
.set CYIPBLOCK_P3_DMA_VERSION, 0
.set CYIPBLOCK_P3_DRQ_VERSION, 0
.set CYIPBLOCK_P3_DSM_VERSION, 0
.set CYIPBLOCK_P3_EMIF_VERSION, 0
.set CYIPBLOCK_P3_I2C_VERSION, 0
.set CYIPBLOCK_P3_LCD_VERSION, 0
.set CYIPBLOCK_P3_LPF_VERSION, 0
.set CYIPBLOCK_P3_OPAMP_VERSION, 0
.set CYIPBLOCK_P3_PM_VERSION, 0
.set CYIPBLOCK_P3_SCCT_VERSION, 0
.set CYIPBLOCK_P3_TIMER_VERSION, 0
.set CYIPBLOCK_P3_USB_VERSION, 0
.set CYIPBLOCK_P3_VIDAC_VERSION, 0
.set CYIPBLOCK_P3_VREF_VERSION, 0
.set CYIPBLOCK_S8_GPIO_VERSION, 0
.set CYIPBLOCK_S8_IRQ_VERSION, 0
.set CYIPBLOCK_S8_SAR_VERSION, 0
.set CYIPBLOCK_S8_SIO_VERSION, 0
.set CYIPBLOCK_S8_UDB_VERSION, 0
.set DMA_CHANNELS_USED__MASK0, 0x00000000
.set CYDEV_BOOTLOADER_ENABLE, 0
.endif
