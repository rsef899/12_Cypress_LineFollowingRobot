;
; File Name: cyfitterrv.inc
; 
; PSoC Creator  4.2
;
; Description:
; 
;
;-------------------------------------------------------------------------------
; Copyright (c) 2007-2018 Cypress Semiconductor.  All rights reserved.
; You may use this file only in accordance with the license, terms, conditions, 
; disclaimers, and limitations in the end user license agreement accompanying 
; the software package with which this file was provided.
;-------------------------------------------------------------------------------

    IF :LNOT::DEF:INCLUDED_CYFITTERRV_INC
INCLUDED_CYFITTERRV_INC EQU 1
    GET cydevicerv.inc
    GET cydevicerv_trm.inc

; LED_1
LED_1__0__INTTYPE EQU CYREG_PICU15_INTTYPE1
LED_1__0__MASK EQU 0x02
LED_1__0__PC EQU CYREG_IO_PC_PRT15_PC1
LED_1__0__PORT EQU 15
LED_1__0__SHIFT EQU 1
LED_1__AG EQU CYREG_PRT15_AG
LED_1__AMUX EQU CYREG_PRT15_AMUX
LED_1__BIE EQU CYREG_PRT15_BIE
LED_1__BIT_MASK EQU CYREG_PRT15_BIT_MASK
LED_1__BYP EQU CYREG_PRT15_BYP
LED_1__CTL EQU CYREG_PRT15_CTL
LED_1__DM0 EQU CYREG_PRT15_DM0
LED_1__DM1 EQU CYREG_PRT15_DM1
LED_1__DM2 EQU CYREG_PRT15_DM2
LED_1__DR EQU CYREG_PRT15_DR
LED_1__INP_DIS EQU CYREG_PRT15_INP_DIS
LED_1__INTTYPE_BASE EQU CYDEV_PICU_INTTYPE_PICU15_BASE
LED_1__LCD_COM_SEG EQU CYREG_PRT15_LCD_COM_SEG
LED_1__LCD_EN EQU CYREG_PRT15_LCD_EN
LED_1__MASK EQU 0x02
LED_1__PORT EQU 15
LED_1__PRT EQU CYREG_PRT15_PRT
LED_1__PRTDSI__CAPS_SEL EQU CYREG_PRT15_CAPS_SEL
LED_1__PRTDSI__DBL_SYNC_IN EQU CYREG_PRT15_DBL_SYNC_IN
LED_1__PRTDSI__OE_SEL0 EQU CYREG_PRT15_OE_SEL0
LED_1__PRTDSI__OE_SEL1 EQU CYREG_PRT15_OE_SEL1
LED_1__PRTDSI__OUT_SEL0 EQU CYREG_PRT15_OUT_SEL0
LED_1__PRTDSI__OUT_SEL1 EQU CYREG_PRT15_OUT_SEL1
LED_1__PRTDSI__SYNC_OUT EQU CYREG_PRT15_SYNC_OUT
LED_1__PS EQU CYREG_PRT15_PS
LED_1__SHIFT EQU 1
LED_1__SLW EQU CYREG_PRT15_SLW

; LED_2
LED_2__0__INTTYPE EQU CYREG_PICU15_INTTYPE2
LED_2__0__MASK EQU 0x04
LED_2__0__PC EQU CYREG_IO_PC_PRT15_PC2
LED_2__0__PORT EQU 15
LED_2__0__SHIFT EQU 2
LED_2__AG EQU CYREG_PRT15_AG
LED_2__AMUX EQU CYREG_PRT15_AMUX
LED_2__BIE EQU CYREG_PRT15_BIE
LED_2__BIT_MASK EQU CYREG_PRT15_BIT_MASK
LED_2__BYP EQU CYREG_PRT15_BYP
LED_2__CTL EQU CYREG_PRT15_CTL
LED_2__DM0 EQU CYREG_PRT15_DM0
LED_2__DM1 EQU CYREG_PRT15_DM1
LED_2__DM2 EQU CYREG_PRT15_DM2
LED_2__DR EQU CYREG_PRT15_DR
LED_2__INP_DIS EQU CYREG_PRT15_INP_DIS
LED_2__INTTYPE_BASE EQU CYDEV_PICU_INTTYPE_PICU15_BASE
LED_2__LCD_COM_SEG EQU CYREG_PRT15_LCD_COM_SEG
LED_2__LCD_EN EQU CYREG_PRT15_LCD_EN
LED_2__MASK EQU 0x04
LED_2__PORT EQU 15
LED_2__PRT EQU CYREG_PRT15_PRT
LED_2__PRTDSI__CAPS_SEL EQU CYREG_PRT15_CAPS_SEL
LED_2__PRTDSI__DBL_SYNC_IN EQU CYREG_PRT15_DBL_SYNC_IN
LED_2__PRTDSI__OE_SEL0 EQU CYREG_PRT15_OE_SEL0
LED_2__PRTDSI__OE_SEL1 EQU CYREG_PRT15_OE_SEL1
LED_2__PRTDSI__OUT_SEL0 EQU CYREG_PRT15_OUT_SEL0
LED_2__PRTDSI__OUT_SEL1 EQU CYREG_PRT15_OUT_SEL1
LED_2__PRTDSI__SYNC_OUT EQU CYREG_PRT15_SYNC_OUT
LED_2__PS EQU CYREG_PRT15_PS
LED_2__SHIFT EQU 2
LED_2__SLW EQU CYREG_PRT15_SLW

; LED_3
LED_3__0__INTTYPE EQU CYREG_PICU15_INTTYPE3
LED_3__0__MASK EQU 0x08
LED_3__0__PC EQU CYREG_IO_PC_PRT15_PC3
LED_3__0__PORT EQU 15
LED_3__0__SHIFT EQU 3
LED_3__AG EQU CYREG_PRT15_AG
LED_3__AMUX EQU CYREG_PRT15_AMUX
LED_3__BIE EQU CYREG_PRT15_BIE
LED_3__BIT_MASK EQU CYREG_PRT15_BIT_MASK
LED_3__BYP EQU CYREG_PRT15_BYP
LED_3__CTL EQU CYREG_PRT15_CTL
LED_3__DM0 EQU CYREG_PRT15_DM0
LED_3__DM1 EQU CYREG_PRT15_DM1
LED_3__DM2 EQU CYREG_PRT15_DM2
LED_3__DR EQU CYREG_PRT15_DR
LED_3__INP_DIS EQU CYREG_PRT15_INP_DIS
LED_3__INTTYPE_BASE EQU CYDEV_PICU_INTTYPE_PICU15_BASE
LED_3__LCD_COM_SEG EQU CYREG_PRT15_LCD_COM_SEG
LED_3__LCD_EN EQU CYREG_PRT15_LCD_EN
LED_3__MASK EQU 0x08
LED_3__PORT EQU 15
LED_3__PRT EQU CYREG_PRT15_PRT
LED_3__PRTDSI__CAPS_SEL EQU CYREG_PRT15_CAPS_SEL
LED_3__PRTDSI__DBL_SYNC_IN EQU CYREG_PRT15_DBL_SYNC_IN
LED_3__PRTDSI__OE_SEL0 EQU CYREG_PRT15_OE_SEL0
LED_3__PRTDSI__OE_SEL1 EQU CYREG_PRT15_OE_SEL1
LED_3__PRTDSI__OUT_SEL0 EQU CYREG_PRT15_OUT_SEL0
LED_3__PRTDSI__OUT_SEL1 EQU CYREG_PRT15_OUT_SEL1
LED_3__PRTDSI__SYNC_OUT EQU CYREG_PRT15_SYNC_OUT
LED_3__PS EQU CYREG_PRT15_PS
LED_3__SHIFT EQU 3
LED_3__SLW EQU CYREG_PRT15_SLW

; LED_4
LED_4__0__INTTYPE EQU CYREG_PICU15_INTTYPE0
LED_4__0__MASK EQU 0x01
LED_4__0__PC EQU CYREG_IO_PC_PRT15_PC0
LED_4__0__PORT EQU 15
LED_4__0__SHIFT EQU 0
LED_4__AG EQU CYREG_PRT15_AG
LED_4__AMUX EQU CYREG_PRT15_AMUX
LED_4__BIE EQU CYREG_PRT15_BIE
LED_4__BIT_MASK EQU CYREG_PRT15_BIT_MASK
LED_4__BYP EQU CYREG_PRT15_BYP
LED_4__CTL EQU CYREG_PRT15_CTL
LED_4__DM0 EQU CYREG_PRT15_DM0
LED_4__DM1 EQU CYREG_PRT15_DM1
LED_4__DM2 EQU CYREG_PRT15_DM2
LED_4__DR EQU CYREG_PRT15_DR
LED_4__INP_DIS EQU CYREG_PRT15_INP_DIS
LED_4__INTTYPE_BASE EQU CYDEV_PICU_INTTYPE_PICU15_BASE
LED_4__LCD_COM_SEG EQU CYREG_PRT15_LCD_COM_SEG
LED_4__LCD_EN EQU CYREG_PRT15_LCD_EN
LED_4__MASK EQU 0x01
LED_4__PORT EQU 15
LED_4__PRT EQU CYREG_PRT15_PRT
LED_4__PRTDSI__CAPS_SEL EQU CYREG_PRT15_CAPS_SEL
LED_4__PRTDSI__DBL_SYNC_IN EQU CYREG_PRT15_DBL_SYNC_IN
LED_4__PRTDSI__OE_SEL0 EQU CYREG_PRT15_OE_SEL0
LED_4__PRTDSI__OE_SEL1 EQU CYREG_PRT15_OE_SEL1
LED_4__PRTDSI__OUT_SEL0 EQU CYREG_PRT15_OUT_SEL0
LED_4__PRTDSI__OUT_SEL1 EQU CYREG_PRT15_OUT_SEL1
LED_4__PRTDSI__SYNC_OUT EQU CYREG_PRT15_SYNC_OUT
LED_4__PS EQU CYREG_PRT15_PS
LED_4__SHIFT EQU 0
LED_4__SLW EQU CYREG_PRT15_SLW

; LED_5
LED_5__0__INTTYPE EQU CYREG_PICU12_INTTYPE0
LED_5__0__MASK EQU 0x01
LED_5__0__PC EQU CYREG_PRT12_PC0
LED_5__0__PORT EQU 12
LED_5__0__SHIFT EQU 0
LED_5__AG EQU CYREG_PRT12_AG
LED_5__BIE EQU CYREG_PRT12_BIE
LED_5__BIT_MASK EQU CYREG_PRT12_BIT_MASK
LED_5__BYP EQU CYREG_PRT12_BYP
LED_5__DM0 EQU CYREG_PRT12_DM0
LED_5__DM1 EQU CYREG_PRT12_DM1
LED_5__DM2 EQU CYREG_PRT12_DM2
LED_5__DR EQU CYREG_PRT12_DR
LED_5__INP_DIS EQU CYREG_PRT12_INP_DIS
LED_5__INTTYPE_BASE EQU CYDEV_PICU_INTTYPE_PICU12_BASE
LED_5__MASK EQU 0x01
LED_5__PORT EQU 12
LED_5__PRT EQU CYREG_PRT12_PRT
LED_5__PRTDSI__DBL_SYNC_IN EQU CYREG_PRT12_DBL_SYNC_IN
LED_5__PRTDSI__OE_SEL0 EQU CYREG_PRT12_OE_SEL0
LED_5__PRTDSI__OE_SEL1 EQU CYREG_PRT12_OE_SEL1
LED_5__PRTDSI__OUT_SEL0 EQU CYREG_PRT12_OUT_SEL0
LED_5__PRTDSI__OUT_SEL1 EQU CYREG_PRT12_OUT_SEL1
LED_5__PRTDSI__SYNC_OUT EQU CYREG_PRT12_SYNC_OUT
LED_5__PS EQU CYREG_PRT12_PS
LED_5__SHIFT EQU 0
LED_5__SIO_CFG EQU CYREG_PRT12_SIO_CFG
LED_5__SIO_DIFF EQU CYREG_PRT12_SIO_DIFF
LED_5__SIO_HYST_EN EQU CYREG_PRT12_SIO_HYST_EN
LED_5__SIO_REG_HIFREQ EQU CYREG_PRT12_SIO_REG_HIFREQ
LED_5__SLW EQU CYREG_PRT12_SLW

; LED_6
LED_6__0__INTTYPE EQU CYREG_PICU12_INTTYPE1
LED_6__0__MASK EQU 0x02
LED_6__0__PC EQU CYREG_PRT12_PC1
LED_6__0__PORT EQU 12
LED_6__0__SHIFT EQU 1
LED_6__AG EQU CYREG_PRT12_AG
LED_6__BIE EQU CYREG_PRT12_BIE
LED_6__BIT_MASK EQU CYREG_PRT12_BIT_MASK
LED_6__BYP EQU CYREG_PRT12_BYP
LED_6__DM0 EQU CYREG_PRT12_DM0
LED_6__DM1 EQU CYREG_PRT12_DM1
LED_6__DM2 EQU CYREG_PRT12_DM2
LED_6__DR EQU CYREG_PRT12_DR
LED_6__INP_DIS EQU CYREG_PRT12_INP_DIS
LED_6__INTTYPE_BASE EQU CYDEV_PICU_INTTYPE_PICU12_BASE
LED_6__MASK EQU 0x02
LED_6__PORT EQU 12
LED_6__PRT EQU CYREG_PRT12_PRT
LED_6__PRTDSI__DBL_SYNC_IN EQU CYREG_PRT12_DBL_SYNC_IN
LED_6__PRTDSI__OE_SEL0 EQU CYREG_PRT12_OE_SEL0
LED_6__PRTDSI__OE_SEL1 EQU CYREG_PRT12_OE_SEL1
LED_6__PRTDSI__OUT_SEL0 EQU CYREG_PRT12_OUT_SEL0
LED_6__PRTDSI__OUT_SEL1 EQU CYREG_PRT12_OUT_SEL1
LED_6__PRTDSI__SYNC_OUT EQU CYREG_PRT12_SYNC_OUT
LED_6__PS EQU CYREG_PRT12_PS
LED_6__SHIFT EQU 1
LED_6__SIO_CFG EQU CYREG_PRT12_SIO_CFG
LED_6__SIO_DIFF EQU CYREG_PRT12_SIO_DIFF
LED_6__SIO_HYST_EN EQU CYREG_PRT12_SIO_HYST_EN
LED_6__SIO_REG_HIFREQ EQU CYREG_PRT12_SIO_REG_HIFREQ
LED_6__SLW EQU CYREG_PRT12_SLW

; LED_7
LED_7__0__INTTYPE EQU CYREG_PICU12_INTTYPE2
LED_7__0__MASK EQU 0x04
LED_7__0__PC EQU CYREG_PRT12_PC2
LED_7__0__PORT EQU 12
LED_7__0__SHIFT EQU 2
LED_7__AG EQU CYREG_PRT12_AG
LED_7__BIE EQU CYREG_PRT12_BIE
LED_7__BIT_MASK EQU CYREG_PRT12_BIT_MASK
LED_7__BYP EQU CYREG_PRT12_BYP
LED_7__DM0 EQU CYREG_PRT12_DM0
LED_7__DM1 EQU CYREG_PRT12_DM1
LED_7__DM2 EQU CYREG_PRT12_DM2
LED_7__DR EQU CYREG_PRT12_DR
LED_7__INP_DIS EQU CYREG_PRT12_INP_DIS
LED_7__INTTYPE_BASE EQU CYDEV_PICU_INTTYPE_PICU12_BASE
LED_7__MASK EQU 0x04
LED_7__PORT EQU 12
LED_7__PRT EQU CYREG_PRT12_PRT
LED_7__PRTDSI__DBL_SYNC_IN EQU CYREG_PRT12_DBL_SYNC_IN
LED_7__PRTDSI__OE_SEL0 EQU CYREG_PRT12_OE_SEL0
LED_7__PRTDSI__OE_SEL1 EQU CYREG_PRT12_OE_SEL1
LED_7__PRTDSI__OUT_SEL0 EQU CYREG_PRT12_OUT_SEL0
LED_7__PRTDSI__OUT_SEL1 EQU CYREG_PRT12_OUT_SEL1
LED_7__PRTDSI__SYNC_OUT EQU CYREG_PRT12_SYNC_OUT
LED_7__PS EQU CYREG_PRT12_PS
LED_7__SHIFT EQU 2
LED_7__SIO_CFG EQU CYREG_PRT12_SIO_CFG
LED_7__SIO_DIFF EQU CYREG_PRT12_SIO_DIFF
LED_7__SIO_HYST_EN EQU CYREG_PRT12_SIO_HYST_EN
LED_7__SIO_REG_HIFREQ EQU CYREG_PRT12_SIO_REG_HIFREQ
LED_7__SLW EQU CYREG_PRT12_SLW

; M1_D1
M1_D1__0__INTTYPE EQU CYREG_PICU3_INTTYPE3
M1_D1__0__MASK EQU 0x08
M1_D1__0__PC EQU CYREG_PRT3_PC3
M1_D1__0__PORT EQU 3
M1_D1__0__SHIFT EQU 3
M1_D1__AG EQU CYREG_PRT3_AG
M1_D1__AMUX EQU CYREG_PRT3_AMUX
M1_D1__BIE EQU CYREG_PRT3_BIE
M1_D1__BIT_MASK EQU CYREG_PRT3_BIT_MASK
M1_D1__BYP EQU CYREG_PRT3_BYP
M1_D1__CTL EQU CYREG_PRT3_CTL
M1_D1__DM0 EQU CYREG_PRT3_DM0
M1_D1__DM1 EQU CYREG_PRT3_DM1
M1_D1__DM2 EQU CYREG_PRT3_DM2
M1_D1__DR EQU CYREG_PRT3_DR
M1_D1__INP_DIS EQU CYREG_PRT3_INP_DIS
M1_D1__INTTYPE_BASE EQU CYDEV_PICU_INTTYPE_PICU3_BASE
M1_D1__LCD_COM_SEG EQU CYREG_PRT3_LCD_COM_SEG
M1_D1__LCD_EN EQU CYREG_PRT3_LCD_EN
M1_D1__MASK EQU 0x08
M1_D1__PORT EQU 3
M1_D1__PRT EQU CYREG_PRT3_PRT
M1_D1__PRTDSI__CAPS_SEL EQU CYREG_PRT3_CAPS_SEL
M1_D1__PRTDSI__DBL_SYNC_IN EQU CYREG_PRT3_DBL_SYNC_IN
M1_D1__PRTDSI__OE_SEL0 EQU CYREG_PRT3_OE_SEL0
M1_D1__PRTDSI__OE_SEL1 EQU CYREG_PRT3_OE_SEL1
M1_D1__PRTDSI__OUT_SEL0 EQU CYREG_PRT3_OUT_SEL0
M1_D1__PRTDSI__OUT_SEL1 EQU CYREG_PRT3_OUT_SEL1
M1_D1__PRTDSI__SYNC_OUT EQU CYREG_PRT3_SYNC_OUT
M1_D1__PS EQU CYREG_PRT3_PS
M1_D1__SHIFT EQU 3
M1_D1__SLW EQU CYREG_PRT3_SLW

; M2_D1
M2_D1__0__INTTYPE EQU CYREG_PICU1_INTTYPE2
M2_D1__0__MASK EQU 0x04
M2_D1__0__PC EQU CYREG_PRT1_PC2
M2_D1__0__PORT EQU 1
M2_D1__0__SHIFT EQU 2
M2_D1__AG EQU CYREG_PRT1_AG
M2_D1__AMUX EQU CYREG_PRT1_AMUX
M2_D1__BIE EQU CYREG_PRT1_BIE
M2_D1__BIT_MASK EQU CYREG_PRT1_BIT_MASK
M2_D1__BYP EQU CYREG_PRT1_BYP
M2_D1__CTL EQU CYREG_PRT1_CTL
M2_D1__DM0 EQU CYREG_PRT1_DM0
M2_D1__DM1 EQU CYREG_PRT1_DM1
M2_D1__DM2 EQU CYREG_PRT1_DM2
M2_D1__DR EQU CYREG_PRT1_DR
M2_D1__INP_DIS EQU CYREG_PRT1_INP_DIS
M2_D1__INTTYPE_BASE EQU CYDEV_PICU_INTTYPE_PICU1_BASE
M2_D1__LCD_COM_SEG EQU CYREG_PRT1_LCD_COM_SEG
M2_D1__LCD_EN EQU CYREG_PRT1_LCD_EN
M2_D1__MASK EQU 0x04
M2_D1__PORT EQU 1
M2_D1__PRT EQU CYREG_PRT1_PRT
M2_D1__PRTDSI__CAPS_SEL EQU CYREG_PRT1_CAPS_SEL
M2_D1__PRTDSI__DBL_SYNC_IN EQU CYREG_PRT1_DBL_SYNC_IN
M2_D1__PRTDSI__OE_SEL0 EQU CYREG_PRT1_OE_SEL0
M2_D1__PRTDSI__OE_SEL1 EQU CYREG_PRT1_OE_SEL1
M2_D1__PRTDSI__OUT_SEL0 EQU CYREG_PRT1_OUT_SEL0
M2_D1__PRTDSI__OUT_SEL1 EQU CYREG_PRT1_OUT_SEL1
M2_D1__PRTDSI__SYNC_OUT EQU CYREG_PRT1_SYNC_OUT
M2_D1__PS EQU CYREG_PRT1_PS
M2_D1__SHIFT EQU 2
M2_D1__SLW EQU CYREG_PRT1_SLW

; PWM_1
PWM_1_PWMHW__CAP0 EQU CYREG_TMR0_CAP0
PWM_1_PWMHW__CAP1 EQU CYREG_TMR0_CAP1
PWM_1_PWMHW__CFG0 EQU CYREG_TMR0_CFG0
PWM_1_PWMHW__CFG1 EQU CYREG_TMR0_CFG1
PWM_1_PWMHW__CFG2 EQU CYREG_TMR0_CFG2
PWM_1_PWMHW__CNT_CMP0 EQU CYREG_TMR0_CNT_CMP0
PWM_1_PWMHW__CNT_CMP1 EQU CYREG_TMR0_CNT_CMP1
PWM_1_PWMHW__PER0 EQU CYREG_TMR0_PER0
PWM_1_PWMHW__PER1 EQU CYREG_TMR0_PER1
PWM_1_PWMHW__PM_ACT_CFG EQU CYREG_PM_ACT_CFG3
PWM_1_PWMHW__PM_ACT_MSK EQU 0x01
PWM_1_PWMHW__PM_STBY_CFG EQU CYREG_PM_STBY_CFG3
PWM_1_PWMHW__PM_STBY_MSK EQU 0x01
PWM_1_PWMHW__RT0 EQU CYREG_TMR0_RT0
PWM_1_PWMHW__RT1 EQU CYREG_TMR0_RT1
PWM_1_PWMHW__SR0 EQU CYREG_TMR0_SR0

; PWM_2
PWM_2_PWMHW__CAP0 EQU CYREG_TMR1_CAP0
PWM_2_PWMHW__CAP1 EQU CYREG_TMR1_CAP1
PWM_2_PWMHW__CFG0 EQU CYREG_TMR1_CFG0
PWM_2_PWMHW__CFG1 EQU CYREG_TMR1_CFG1
PWM_2_PWMHW__CFG2 EQU CYREG_TMR1_CFG2
PWM_2_PWMHW__CNT_CMP0 EQU CYREG_TMR1_CNT_CMP0
PWM_2_PWMHW__CNT_CMP1 EQU CYREG_TMR1_CNT_CMP1
PWM_2_PWMHW__PER0 EQU CYREG_TMR1_PER0
PWM_2_PWMHW__PER1 EQU CYREG_TMR1_PER1
PWM_2_PWMHW__PM_ACT_CFG EQU CYREG_PM_ACT_CFG3
PWM_2_PWMHW__PM_ACT_MSK EQU 0x02
PWM_2_PWMHW__PM_STBY_CFG EQU CYREG_PM_STBY_CFG3
PWM_2_PWMHW__PM_STBY_MSK EQU 0x02
PWM_2_PWMHW__RT0 EQU CYREG_TMR1_RT0
PWM_2_PWMHW__RT1 EQU CYREG_TMR1_RT1
PWM_2_PWMHW__SR0 EQU CYREG_TMR1_SR0

; SEN_1
SEN_1__0__INTTYPE EQU CYREG_PICU3_INTTYPE0
SEN_1__0__MASK EQU 0x01
SEN_1__0__PC EQU CYREG_PRT3_PC0
SEN_1__0__PORT EQU 3
SEN_1__0__SHIFT EQU 0
SEN_1__AG EQU CYREG_PRT3_AG
SEN_1__AMUX EQU CYREG_PRT3_AMUX
SEN_1__BIE EQU CYREG_PRT3_BIE
SEN_1__BIT_MASK EQU CYREG_PRT3_BIT_MASK
SEN_1__BYP EQU CYREG_PRT3_BYP
SEN_1__CTL EQU CYREG_PRT3_CTL
SEN_1__DM0 EQU CYREG_PRT3_DM0
SEN_1__DM1 EQU CYREG_PRT3_DM1
SEN_1__DM2 EQU CYREG_PRT3_DM2
SEN_1__DR EQU CYREG_PRT3_DR
SEN_1__INP_DIS EQU CYREG_PRT3_INP_DIS
SEN_1__INTTYPE_BASE EQU CYDEV_PICU_INTTYPE_PICU3_BASE
SEN_1__LCD_COM_SEG EQU CYREG_PRT3_LCD_COM_SEG
SEN_1__LCD_EN EQU CYREG_PRT3_LCD_EN
SEN_1__MASK EQU 0x01
SEN_1__PORT EQU 3
SEN_1__PRT EQU CYREG_PRT3_PRT
SEN_1__PRTDSI__CAPS_SEL EQU CYREG_PRT3_CAPS_SEL
SEN_1__PRTDSI__DBL_SYNC_IN EQU CYREG_PRT3_DBL_SYNC_IN
SEN_1__PRTDSI__OE_SEL0 EQU CYREG_PRT3_OE_SEL0
SEN_1__PRTDSI__OE_SEL1 EQU CYREG_PRT3_OE_SEL1
SEN_1__PRTDSI__OUT_SEL0 EQU CYREG_PRT3_OUT_SEL0
SEN_1__PRTDSI__OUT_SEL1 EQU CYREG_PRT3_OUT_SEL1
SEN_1__PRTDSI__SYNC_OUT EQU CYREG_PRT3_SYNC_OUT
SEN_1__PS EQU CYREG_PRT3_PS
SEN_1__SHIFT EQU 0
SEN_1__SLW EQU CYREG_PRT3_SLW

; SEN_2
SEN_2__0__INTTYPE EQU CYREG_PICU3_INTTYPE1
SEN_2__0__MASK EQU 0x02
SEN_2__0__PC EQU CYREG_PRT3_PC1
SEN_2__0__PORT EQU 3
SEN_2__0__SHIFT EQU 1
SEN_2__AG EQU CYREG_PRT3_AG
SEN_2__AMUX EQU CYREG_PRT3_AMUX
SEN_2__BIE EQU CYREG_PRT3_BIE
SEN_2__BIT_MASK EQU CYREG_PRT3_BIT_MASK
SEN_2__BYP EQU CYREG_PRT3_BYP
SEN_2__CTL EQU CYREG_PRT3_CTL
SEN_2__DM0 EQU CYREG_PRT3_DM0
SEN_2__DM1 EQU CYREG_PRT3_DM1
SEN_2__DM2 EQU CYREG_PRT3_DM2
SEN_2__DR EQU CYREG_PRT3_DR
SEN_2__INP_DIS EQU CYREG_PRT3_INP_DIS
SEN_2__INTTYPE_BASE EQU CYDEV_PICU_INTTYPE_PICU3_BASE
SEN_2__LCD_COM_SEG EQU CYREG_PRT3_LCD_COM_SEG
SEN_2__LCD_EN EQU CYREG_PRT3_LCD_EN
SEN_2__MASK EQU 0x02
SEN_2__PORT EQU 3
SEN_2__PRT EQU CYREG_PRT3_PRT
SEN_2__PRTDSI__CAPS_SEL EQU CYREG_PRT3_CAPS_SEL
SEN_2__PRTDSI__DBL_SYNC_IN EQU CYREG_PRT3_DBL_SYNC_IN
SEN_2__PRTDSI__OE_SEL0 EQU CYREG_PRT3_OE_SEL0
SEN_2__PRTDSI__OE_SEL1 EQU CYREG_PRT3_OE_SEL1
SEN_2__PRTDSI__OUT_SEL0 EQU CYREG_PRT3_OUT_SEL0
SEN_2__PRTDSI__OUT_SEL1 EQU CYREG_PRT3_OUT_SEL1
SEN_2__PRTDSI__SYNC_OUT EQU CYREG_PRT3_SYNC_OUT
SEN_2__PS EQU CYREG_PRT3_PS
SEN_2__SHIFT EQU 1
SEN_2__SLW EQU CYREG_PRT3_SLW

; SEN_3
SEN_3__0__INTTYPE EQU CYREG_PICU1_INTTYPE7
SEN_3__0__MASK EQU 0x80
SEN_3__0__PC EQU CYREG_PRT1_PC7
SEN_3__0__PORT EQU 1
SEN_3__0__SHIFT EQU 7
SEN_3__AG EQU CYREG_PRT1_AG
SEN_3__AMUX EQU CYREG_PRT1_AMUX
SEN_3__BIE EQU CYREG_PRT1_BIE
SEN_3__BIT_MASK EQU CYREG_PRT1_BIT_MASK
SEN_3__BYP EQU CYREG_PRT1_BYP
SEN_3__CTL EQU CYREG_PRT1_CTL
SEN_3__DM0 EQU CYREG_PRT1_DM0
SEN_3__DM1 EQU CYREG_PRT1_DM1
SEN_3__DM2 EQU CYREG_PRT1_DM2
SEN_3__DR EQU CYREG_PRT1_DR
SEN_3__INP_DIS EQU CYREG_PRT1_INP_DIS
SEN_3__INTTYPE_BASE EQU CYDEV_PICU_INTTYPE_PICU1_BASE
SEN_3__LCD_COM_SEG EQU CYREG_PRT1_LCD_COM_SEG
SEN_3__LCD_EN EQU CYREG_PRT1_LCD_EN
SEN_3__MASK EQU 0x80
SEN_3__PORT EQU 1
SEN_3__PRT EQU CYREG_PRT1_PRT
SEN_3__PRTDSI__CAPS_SEL EQU CYREG_PRT1_CAPS_SEL
SEN_3__PRTDSI__DBL_SYNC_IN EQU CYREG_PRT1_DBL_SYNC_IN
SEN_3__PRTDSI__OE_SEL0 EQU CYREG_PRT1_OE_SEL0
SEN_3__PRTDSI__OE_SEL1 EQU CYREG_PRT1_OE_SEL1
SEN_3__PRTDSI__OUT_SEL0 EQU CYREG_PRT1_OUT_SEL0
SEN_3__PRTDSI__OUT_SEL1 EQU CYREG_PRT1_OUT_SEL1
SEN_3__PRTDSI__SYNC_OUT EQU CYREG_PRT1_SYNC_OUT
SEN_3__PS EQU CYREG_PRT1_PS
SEN_3__SHIFT EQU 7
SEN_3__SLW EQU CYREG_PRT1_SLW

; SEN_4
SEN_4__0__INTTYPE EQU CYREG_PICU0_INTTYPE3
SEN_4__0__MASK EQU 0x08
SEN_4__0__PC EQU CYREG_PRT0_PC3
SEN_4__0__PORT EQU 0
SEN_4__0__SHIFT EQU 3
SEN_4__AG EQU CYREG_PRT0_AG
SEN_4__AMUX EQU CYREG_PRT0_AMUX
SEN_4__BIE EQU CYREG_PRT0_BIE
SEN_4__BIT_MASK EQU CYREG_PRT0_BIT_MASK
SEN_4__BYP EQU CYREG_PRT0_BYP
SEN_4__CTL EQU CYREG_PRT0_CTL
SEN_4__DM0 EQU CYREG_PRT0_DM0
SEN_4__DM1 EQU CYREG_PRT0_DM1
SEN_4__DM2 EQU CYREG_PRT0_DM2
SEN_4__DR EQU CYREG_PRT0_DR
SEN_4__INP_DIS EQU CYREG_PRT0_INP_DIS
SEN_4__INTTYPE_BASE EQU CYDEV_PICU_INTTYPE_PICU0_BASE
SEN_4__LCD_COM_SEG EQU CYREG_PRT0_LCD_COM_SEG
SEN_4__LCD_EN EQU CYREG_PRT0_LCD_EN
SEN_4__MASK EQU 0x08
SEN_4__PORT EQU 0
SEN_4__PRT EQU CYREG_PRT0_PRT
SEN_4__PRTDSI__CAPS_SEL EQU CYREG_PRT0_CAPS_SEL
SEN_4__PRTDSI__DBL_SYNC_IN EQU CYREG_PRT0_DBL_SYNC_IN
SEN_4__PRTDSI__OE_SEL0 EQU CYREG_PRT0_OE_SEL0
SEN_4__PRTDSI__OE_SEL1 EQU CYREG_PRT0_OE_SEL1
SEN_4__PRTDSI__OUT_SEL0 EQU CYREG_PRT0_OUT_SEL0
SEN_4__PRTDSI__OUT_SEL1 EQU CYREG_PRT0_OUT_SEL1
SEN_4__PRTDSI__SYNC_OUT EQU CYREG_PRT0_SYNC_OUT
SEN_4__PS EQU CYREG_PRT0_PS
SEN_4__SHIFT EQU 3
SEN_4__SLW EQU CYREG_PRT0_SLW

; SEN_5
SEN_5__0__INTTYPE EQU CYREG_PICU2_INTTYPE7
SEN_5__0__MASK EQU 0x80
SEN_5__0__PC EQU CYREG_PRT2_PC7
SEN_5__0__PORT EQU 2
SEN_5__0__SHIFT EQU 7
SEN_5__AG EQU CYREG_PRT2_AG
SEN_5__AMUX EQU CYREG_PRT2_AMUX
SEN_5__BIE EQU CYREG_PRT2_BIE
SEN_5__BIT_MASK EQU CYREG_PRT2_BIT_MASK
SEN_5__BYP EQU CYREG_PRT2_BYP
SEN_5__CTL EQU CYREG_PRT2_CTL
SEN_5__DM0 EQU CYREG_PRT2_DM0
SEN_5__DM1 EQU CYREG_PRT2_DM1
SEN_5__DM2 EQU CYREG_PRT2_DM2
SEN_5__DR EQU CYREG_PRT2_DR
SEN_5__INP_DIS EQU CYREG_PRT2_INP_DIS
SEN_5__INTTYPE_BASE EQU CYDEV_PICU_INTTYPE_PICU2_BASE
SEN_5__LCD_COM_SEG EQU CYREG_PRT2_LCD_COM_SEG
SEN_5__LCD_EN EQU CYREG_PRT2_LCD_EN
SEN_5__MASK EQU 0x80
SEN_5__PORT EQU 2
SEN_5__PRT EQU CYREG_PRT2_PRT
SEN_5__PRTDSI__CAPS_SEL EQU CYREG_PRT2_CAPS_SEL
SEN_5__PRTDSI__DBL_SYNC_IN EQU CYREG_PRT2_DBL_SYNC_IN
SEN_5__PRTDSI__OE_SEL0 EQU CYREG_PRT2_OE_SEL0
SEN_5__PRTDSI__OE_SEL1 EQU CYREG_PRT2_OE_SEL1
SEN_5__PRTDSI__OUT_SEL0 EQU CYREG_PRT2_OUT_SEL0
SEN_5__PRTDSI__OUT_SEL1 EQU CYREG_PRT2_OUT_SEL1
SEN_5__PRTDSI__SYNC_OUT EQU CYREG_PRT2_SYNC_OUT
SEN_5__PS EQU CYREG_PRT2_PS
SEN_5__SHIFT EQU 7
SEN_5__SLW EQU CYREG_PRT2_SLW

; SEN_6
SEN_6__0__INTTYPE EQU CYREG_PICU1_INTTYPE6
SEN_6__0__MASK EQU 0x40
SEN_6__0__PC EQU CYREG_PRT1_PC6
SEN_6__0__PORT EQU 1
SEN_6__0__SHIFT EQU 6
SEN_6__AG EQU CYREG_PRT1_AG
SEN_6__AMUX EQU CYREG_PRT1_AMUX
SEN_6__BIE EQU CYREG_PRT1_BIE
SEN_6__BIT_MASK EQU CYREG_PRT1_BIT_MASK
SEN_6__BYP EQU CYREG_PRT1_BYP
SEN_6__CTL EQU CYREG_PRT1_CTL
SEN_6__DM0 EQU CYREG_PRT1_DM0
SEN_6__DM1 EQU CYREG_PRT1_DM1
SEN_6__DM2 EQU CYREG_PRT1_DM2
SEN_6__DR EQU CYREG_PRT1_DR
SEN_6__INP_DIS EQU CYREG_PRT1_INP_DIS
SEN_6__INTTYPE_BASE EQU CYDEV_PICU_INTTYPE_PICU1_BASE
SEN_6__LCD_COM_SEG EQU CYREG_PRT1_LCD_COM_SEG
SEN_6__LCD_EN EQU CYREG_PRT1_LCD_EN
SEN_6__MASK EQU 0x40
SEN_6__PORT EQU 1
SEN_6__PRT EQU CYREG_PRT1_PRT
SEN_6__PRTDSI__CAPS_SEL EQU CYREG_PRT1_CAPS_SEL
SEN_6__PRTDSI__DBL_SYNC_IN EQU CYREG_PRT1_DBL_SYNC_IN
SEN_6__PRTDSI__OE_SEL0 EQU CYREG_PRT1_OE_SEL0
SEN_6__PRTDSI__OE_SEL1 EQU CYREG_PRT1_OE_SEL1
SEN_6__PRTDSI__OUT_SEL0 EQU CYREG_PRT1_OUT_SEL0
SEN_6__PRTDSI__OUT_SEL1 EQU CYREG_PRT1_OUT_SEL1
SEN_6__PRTDSI__SYNC_OUT EQU CYREG_PRT1_SYNC_OUT
SEN_6__PS EQU CYREG_PRT1_PS
SEN_6__SHIFT EQU 6
SEN_6__SLW EQU CYREG_PRT1_SLW

; SEN_7
SEN_7__0__INTTYPE EQU CYREG_PICU0_INTTYPE7
SEN_7__0__MASK EQU 0x80
SEN_7__0__PC EQU CYREG_PRT0_PC7
SEN_7__0__PORT EQU 0
SEN_7__0__SHIFT EQU 7
SEN_7__AG EQU CYREG_PRT0_AG
SEN_7__AMUX EQU CYREG_PRT0_AMUX
SEN_7__BIE EQU CYREG_PRT0_BIE
SEN_7__BIT_MASK EQU CYREG_PRT0_BIT_MASK
SEN_7__BYP EQU CYREG_PRT0_BYP
SEN_7__CTL EQU CYREG_PRT0_CTL
SEN_7__DM0 EQU CYREG_PRT0_DM0
SEN_7__DM1 EQU CYREG_PRT0_DM1
SEN_7__DM2 EQU CYREG_PRT0_DM2
SEN_7__DR EQU CYREG_PRT0_DR
SEN_7__INP_DIS EQU CYREG_PRT0_INP_DIS
SEN_7__INTTYPE_BASE EQU CYDEV_PICU_INTTYPE_PICU0_BASE
SEN_7__LCD_COM_SEG EQU CYREG_PRT0_LCD_COM_SEG
SEN_7__LCD_EN EQU CYREG_PRT0_LCD_EN
SEN_7__MASK EQU 0x80
SEN_7__PORT EQU 0
SEN_7__PRT EQU CYREG_PRT0_PRT
SEN_7__PRTDSI__CAPS_SEL EQU CYREG_PRT0_CAPS_SEL
SEN_7__PRTDSI__DBL_SYNC_IN EQU CYREG_PRT0_DBL_SYNC_IN
SEN_7__PRTDSI__OE_SEL0 EQU CYREG_PRT0_OE_SEL0
SEN_7__PRTDSI__OE_SEL1 EQU CYREG_PRT0_OE_SEL1
SEN_7__PRTDSI__OUT_SEL0 EQU CYREG_PRT0_OUT_SEL0
SEN_7__PRTDSI__OUT_SEL1 EQU CYREG_PRT0_OUT_SEL1
SEN_7__PRTDSI__SYNC_OUT EQU CYREG_PRT0_SYNC_OUT
SEN_7__PS EQU CYREG_PRT0_PS
SEN_7__SHIFT EQU 7
SEN_7__SLW EQU CYREG_PRT0_SLW

; M1_IN1
M1_IN1__0__INTTYPE EQU CYREG_PICU3_INTTYPE4
M1_IN1__0__MASK EQU 0x10
M1_IN1__0__PC EQU CYREG_PRT3_PC4
M1_IN1__0__PORT EQU 3
M1_IN1__0__SHIFT EQU 4
M1_IN1__AG EQU CYREG_PRT3_AG
M1_IN1__AMUX EQU CYREG_PRT3_AMUX
M1_IN1__BIE EQU CYREG_PRT3_BIE
M1_IN1__BIT_MASK EQU CYREG_PRT3_BIT_MASK
M1_IN1__BYP EQU CYREG_PRT3_BYP
M1_IN1__CTL EQU CYREG_PRT3_CTL
M1_IN1__DM0 EQU CYREG_PRT3_DM0
M1_IN1__DM1 EQU CYREG_PRT3_DM1
M1_IN1__DM2 EQU CYREG_PRT3_DM2
M1_IN1__DR EQU CYREG_PRT3_DR
M1_IN1__INP_DIS EQU CYREG_PRT3_INP_DIS
M1_IN1__INTTYPE_BASE EQU CYDEV_PICU_INTTYPE_PICU3_BASE
M1_IN1__LCD_COM_SEG EQU CYREG_PRT3_LCD_COM_SEG
M1_IN1__LCD_EN EQU CYREG_PRT3_LCD_EN
M1_IN1__MASK EQU 0x10
M1_IN1__PORT EQU 3
M1_IN1__PRT EQU CYREG_PRT3_PRT
M1_IN1__PRTDSI__CAPS_SEL EQU CYREG_PRT3_CAPS_SEL
M1_IN1__PRTDSI__DBL_SYNC_IN EQU CYREG_PRT3_DBL_SYNC_IN
M1_IN1__PRTDSI__OE_SEL0 EQU CYREG_PRT3_OE_SEL0
M1_IN1__PRTDSI__OE_SEL1 EQU CYREG_PRT3_OE_SEL1
M1_IN1__PRTDSI__OUT_SEL0 EQU CYREG_PRT3_OUT_SEL0
M1_IN1__PRTDSI__OUT_SEL1 EQU CYREG_PRT3_OUT_SEL1
M1_IN1__PRTDSI__SYNC_OUT EQU CYREG_PRT3_SYNC_OUT
M1_IN1__PS EQU CYREG_PRT3_PS
M1_IN1__SHIFT EQU 4
M1_IN1__SLW EQU CYREG_PRT3_SLW

; M1_IN2
M1_IN2__0__INTTYPE EQU CYREG_PICU3_INTTYPE5
M1_IN2__0__MASK EQU 0x20
M1_IN2__0__PC EQU CYREG_PRT3_PC5
M1_IN2__0__PORT EQU 3
M1_IN2__0__SHIFT EQU 5
M1_IN2__AG EQU CYREG_PRT3_AG
M1_IN2__AMUX EQU CYREG_PRT3_AMUX
M1_IN2__BIE EQU CYREG_PRT3_BIE
M1_IN2__BIT_MASK EQU CYREG_PRT3_BIT_MASK
M1_IN2__BYP EQU CYREG_PRT3_BYP
M1_IN2__CTL EQU CYREG_PRT3_CTL
M1_IN2__DM0 EQU CYREG_PRT3_DM0
M1_IN2__DM1 EQU CYREG_PRT3_DM1
M1_IN2__DM2 EQU CYREG_PRT3_DM2
M1_IN2__DR EQU CYREG_PRT3_DR
M1_IN2__INP_DIS EQU CYREG_PRT3_INP_DIS
M1_IN2__INTTYPE_BASE EQU CYDEV_PICU_INTTYPE_PICU3_BASE
M1_IN2__LCD_COM_SEG EQU CYREG_PRT3_LCD_COM_SEG
M1_IN2__LCD_EN EQU CYREG_PRT3_LCD_EN
M1_IN2__MASK EQU 0x20
M1_IN2__PORT EQU 3
M1_IN2__PRT EQU CYREG_PRT3_PRT
M1_IN2__PRTDSI__CAPS_SEL EQU CYREG_PRT3_CAPS_SEL
M1_IN2__PRTDSI__DBL_SYNC_IN EQU CYREG_PRT3_DBL_SYNC_IN
M1_IN2__PRTDSI__OE_SEL0 EQU CYREG_PRT3_OE_SEL0
M1_IN2__PRTDSI__OE_SEL1 EQU CYREG_PRT3_OE_SEL1
M1_IN2__PRTDSI__OUT_SEL0 EQU CYREG_PRT3_OUT_SEL0
M1_IN2__PRTDSI__OUT_SEL1 EQU CYREG_PRT3_OUT_SEL1
M1_IN2__PRTDSI__SYNC_OUT EQU CYREG_PRT3_SYNC_OUT
M1_IN2__PS EQU CYREG_PRT3_PS
M1_IN2__SHIFT EQU 5
M1_IN2__SLW EQU CYREG_PRT3_SLW

; M1_INV
M1_INV__0__INTTYPE EQU CYREG_PICU3_INTTYPE7
M1_INV__0__MASK EQU 0x80
M1_INV__0__PC EQU CYREG_PRT3_PC7
M1_INV__0__PORT EQU 3
M1_INV__0__SHIFT EQU 7
M1_INV__AG EQU CYREG_PRT3_AG
M1_INV__AMUX EQU CYREG_PRT3_AMUX
M1_INV__BIE EQU CYREG_PRT3_BIE
M1_INV__BIT_MASK EQU CYREG_PRT3_BIT_MASK
M1_INV__BYP EQU CYREG_PRT3_BYP
M1_INV__CTL EQU CYREG_PRT3_CTL
M1_INV__DM0 EQU CYREG_PRT3_DM0
M1_INV__DM1 EQU CYREG_PRT3_DM1
M1_INV__DM2 EQU CYREG_PRT3_DM2
M1_INV__DR EQU CYREG_PRT3_DR
M1_INV__INP_DIS EQU CYREG_PRT3_INP_DIS
M1_INV__INTTYPE_BASE EQU CYDEV_PICU_INTTYPE_PICU3_BASE
M1_INV__LCD_COM_SEG EQU CYREG_PRT3_LCD_COM_SEG
M1_INV__LCD_EN EQU CYREG_PRT3_LCD_EN
M1_INV__MASK EQU 0x80
M1_INV__PORT EQU 3
M1_INV__PRT EQU CYREG_PRT3_PRT
M1_INV__PRTDSI__CAPS_SEL EQU CYREG_PRT3_CAPS_SEL
M1_INV__PRTDSI__DBL_SYNC_IN EQU CYREG_PRT3_DBL_SYNC_IN
M1_INV__PRTDSI__OE_SEL0 EQU CYREG_PRT3_OE_SEL0
M1_INV__PRTDSI__OE_SEL1 EQU CYREG_PRT3_OE_SEL1
M1_INV__PRTDSI__OUT_SEL0 EQU CYREG_PRT3_OUT_SEL0
M1_INV__PRTDSI__OUT_SEL1 EQU CYREG_PRT3_OUT_SEL1
M1_INV__PRTDSI__SYNC_OUT EQU CYREG_PRT3_SYNC_OUT
M1_INV__PS EQU CYREG_PRT3_PS
M1_INV__SHIFT EQU 7
M1_INV__SLW EQU CYREG_PRT3_SLW

; M2_IN1
M2_IN1__0__INTTYPE EQU CYREG_PICU1_INTTYPE4
M2_IN1__0__MASK EQU 0x10
M2_IN1__0__PC EQU CYREG_PRT1_PC4
M2_IN1__0__PORT EQU 1
M2_IN1__0__SHIFT EQU 4
M2_IN1__AG EQU CYREG_PRT1_AG
M2_IN1__AMUX EQU CYREG_PRT1_AMUX
M2_IN1__BIE EQU CYREG_PRT1_BIE
M2_IN1__BIT_MASK EQU CYREG_PRT1_BIT_MASK
M2_IN1__BYP EQU CYREG_PRT1_BYP
M2_IN1__CTL EQU CYREG_PRT1_CTL
M2_IN1__DM0 EQU CYREG_PRT1_DM0
M2_IN1__DM1 EQU CYREG_PRT1_DM1
M2_IN1__DM2 EQU CYREG_PRT1_DM2
M2_IN1__DR EQU CYREG_PRT1_DR
M2_IN1__INP_DIS EQU CYREG_PRT1_INP_DIS
M2_IN1__INTTYPE_BASE EQU CYDEV_PICU_INTTYPE_PICU1_BASE
M2_IN1__LCD_COM_SEG EQU CYREG_PRT1_LCD_COM_SEG
M2_IN1__LCD_EN EQU CYREG_PRT1_LCD_EN
M2_IN1__MASK EQU 0x10
M2_IN1__PORT EQU 1
M2_IN1__PRT EQU CYREG_PRT1_PRT
M2_IN1__PRTDSI__CAPS_SEL EQU CYREG_PRT1_CAPS_SEL
M2_IN1__PRTDSI__DBL_SYNC_IN EQU CYREG_PRT1_DBL_SYNC_IN
M2_IN1__PRTDSI__OE_SEL0 EQU CYREG_PRT1_OE_SEL0
M2_IN1__PRTDSI__OE_SEL1 EQU CYREG_PRT1_OE_SEL1
M2_IN1__PRTDSI__OUT_SEL0 EQU CYREG_PRT1_OUT_SEL0
M2_IN1__PRTDSI__OUT_SEL1 EQU CYREG_PRT1_OUT_SEL1
M2_IN1__PRTDSI__SYNC_OUT EQU CYREG_PRT1_SYNC_OUT
M2_IN1__PS EQU CYREG_PRT1_PS
M2_IN1__SHIFT EQU 4
M2_IN1__SLW EQU CYREG_PRT1_SLW

; M2_IN2
M2_IN2__0__INTTYPE EQU CYREG_PICU1_INTTYPE5
M2_IN2__0__MASK EQU 0x20
M2_IN2__0__PC EQU CYREG_PRT1_PC5
M2_IN2__0__PORT EQU 1
M2_IN2__0__SHIFT EQU 5
M2_IN2__AG EQU CYREG_PRT1_AG
M2_IN2__AMUX EQU CYREG_PRT1_AMUX
M2_IN2__BIE EQU CYREG_PRT1_BIE
M2_IN2__BIT_MASK EQU CYREG_PRT1_BIT_MASK
M2_IN2__BYP EQU CYREG_PRT1_BYP
M2_IN2__CTL EQU CYREG_PRT1_CTL
M2_IN2__DM0 EQU CYREG_PRT1_DM0
M2_IN2__DM1 EQU CYREG_PRT1_DM1
M2_IN2__DM2 EQU CYREG_PRT1_DM2
M2_IN2__DR EQU CYREG_PRT1_DR
M2_IN2__INP_DIS EQU CYREG_PRT1_INP_DIS
M2_IN2__INTTYPE_BASE EQU CYDEV_PICU_INTTYPE_PICU1_BASE
M2_IN2__LCD_COM_SEG EQU CYREG_PRT1_LCD_COM_SEG
M2_IN2__LCD_EN EQU CYREG_PRT1_LCD_EN
M2_IN2__MASK EQU 0x20
M2_IN2__PORT EQU 1
M2_IN2__PRT EQU CYREG_PRT1_PRT
M2_IN2__PRTDSI__CAPS_SEL EQU CYREG_PRT1_CAPS_SEL
M2_IN2__PRTDSI__DBL_SYNC_IN EQU CYREG_PRT1_DBL_SYNC_IN
M2_IN2__PRTDSI__OE_SEL0 EQU CYREG_PRT1_OE_SEL0
M2_IN2__PRTDSI__OE_SEL1 EQU CYREG_PRT1_OE_SEL1
M2_IN2__PRTDSI__OUT_SEL0 EQU CYREG_PRT1_OUT_SEL0
M2_IN2__PRTDSI__OUT_SEL1 EQU CYREG_PRT1_OUT_SEL1
M2_IN2__PRTDSI__SYNC_OUT EQU CYREG_PRT1_SYNC_OUT
M2_IN2__PS EQU CYREG_PRT1_PS
M2_IN2__SHIFT EQU 5
M2_IN2__SLW EQU CYREG_PRT1_SLW

; M2_INV
M2_INV__0__INTTYPE EQU CYREG_PICU1_INTTYPE3
M2_INV__0__MASK EQU 0x08
M2_INV__0__PC EQU CYREG_PRT1_PC3
M2_INV__0__PORT EQU 1
M2_INV__0__SHIFT EQU 3
M2_INV__AG EQU CYREG_PRT1_AG
M2_INV__AMUX EQU CYREG_PRT1_AMUX
M2_INV__BIE EQU CYREG_PRT1_BIE
M2_INV__BIT_MASK EQU CYREG_PRT1_BIT_MASK
M2_INV__BYP EQU CYREG_PRT1_BYP
M2_INV__CTL EQU CYREG_PRT1_CTL
M2_INV__DM0 EQU CYREG_PRT1_DM0
M2_INV__DM1 EQU CYREG_PRT1_DM1
M2_INV__DM2 EQU CYREG_PRT1_DM2
M2_INV__DR EQU CYREG_PRT1_DR
M2_INV__INP_DIS EQU CYREG_PRT1_INP_DIS
M2_INV__INTTYPE_BASE EQU CYDEV_PICU_INTTYPE_PICU1_BASE
M2_INV__LCD_COM_SEG EQU CYREG_PRT1_LCD_COM_SEG
M2_INV__LCD_EN EQU CYREG_PRT1_LCD_EN
M2_INV__MASK EQU 0x08
M2_INV__PORT EQU 1
M2_INV__PRT EQU CYREG_PRT1_PRT
M2_INV__PRTDSI__CAPS_SEL EQU CYREG_PRT1_CAPS_SEL
M2_INV__PRTDSI__DBL_SYNC_IN EQU CYREG_PRT1_DBL_SYNC_IN
M2_INV__PRTDSI__OE_SEL0 EQU CYREG_PRT1_OE_SEL0
M2_INV__PRTDSI__OE_SEL1 EQU CYREG_PRT1_OE_SEL1
M2_INV__PRTDSI__OUT_SEL0 EQU CYREG_PRT1_OUT_SEL0
M2_INV__PRTDSI__OUT_SEL1 EQU CYREG_PRT1_OUT_SEL1
M2_INV__PRTDSI__SYNC_OUT EQU CYREG_PRT1_SYNC_OUT
M2_INV__PS EQU CYREG_PRT1_PS
M2_INV__SHIFT EQU 3
M2_INV__SLW EQU CYREG_PRT1_SLW

; Clock_PWM
Clock_PWM__CFG0 EQU CYREG_CLKDIST_DCFG0_CFG0
Clock_PWM__CFG1 EQU CYREG_CLKDIST_DCFG0_CFG1
Clock_PWM__CFG2 EQU CYREG_CLKDIST_DCFG0_CFG2
Clock_PWM__CFG2_SRC_SEL_MASK EQU 0x07
Clock_PWM__INDEX EQU 0x00
Clock_PWM__PM_ACT_CFG EQU CYREG_PM_ACT_CFG2
Clock_PWM__PM_ACT_MSK EQU 0x01
Clock_PWM__PM_STBY_CFG EQU CYREG_PM_STBY_CFG2
Clock_PWM__PM_STBY_MSK EQU 0x01

; Miscellaneous
BCLK__BUS_CLK__HZ EQU 60000000
BCLK__BUS_CLK__KHZ EQU 60000
BCLK__BUS_CLK__MHZ EQU 60
CYDEV_CHIP_DIE_LEOPARD EQU 1
CYDEV_CHIP_DIE_PSOC4A EQU 18
CYDEV_CHIP_DIE_PSOC5LP EQU 2
CYDEV_CHIP_DIE_PSOC5TM EQU 3
CYDEV_CHIP_DIE_TMA4 EQU 4
CYDEV_CHIP_DIE_UNKNOWN EQU 0
CYDEV_CHIP_FAMILY_FM0P EQU 5
CYDEV_CHIP_FAMILY_FM3 EQU 6
CYDEV_CHIP_FAMILY_FM4 EQU 7
CYDEV_CHIP_FAMILY_PSOC3 EQU 1
CYDEV_CHIP_FAMILY_PSOC4 EQU 2
CYDEV_CHIP_FAMILY_PSOC5 EQU 3
CYDEV_CHIP_FAMILY_PSOC6 EQU 4
CYDEV_CHIP_FAMILY_UNKNOWN EQU 0
CYDEV_CHIP_FAMILY_USED EQU CYDEV_CHIP_FAMILY_PSOC5
CYDEV_CHIP_JTAG_ID EQU 0x2E161069
CYDEV_CHIP_MEMBER_3A EQU 1
CYDEV_CHIP_MEMBER_4A EQU 18
CYDEV_CHIP_MEMBER_4D EQU 13
CYDEV_CHIP_MEMBER_4E EQU 6
CYDEV_CHIP_MEMBER_4F EQU 19
CYDEV_CHIP_MEMBER_4G EQU 4
CYDEV_CHIP_MEMBER_4H EQU 17
CYDEV_CHIP_MEMBER_4I EQU 23
CYDEV_CHIP_MEMBER_4J EQU 14
CYDEV_CHIP_MEMBER_4K EQU 15
CYDEV_CHIP_MEMBER_4L EQU 22
CYDEV_CHIP_MEMBER_4M EQU 21
CYDEV_CHIP_MEMBER_4N EQU 10
CYDEV_CHIP_MEMBER_4O EQU 7
CYDEV_CHIP_MEMBER_4P EQU 20
CYDEV_CHIP_MEMBER_4Q EQU 12
CYDEV_CHIP_MEMBER_4R EQU 8
CYDEV_CHIP_MEMBER_4S EQU 11
CYDEV_CHIP_MEMBER_4T EQU 9
CYDEV_CHIP_MEMBER_4U EQU 5
CYDEV_CHIP_MEMBER_4V EQU 16
CYDEV_CHIP_MEMBER_5A EQU 3
CYDEV_CHIP_MEMBER_5B EQU 2
CYDEV_CHIP_MEMBER_6A EQU 24
CYDEV_CHIP_MEMBER_FM3 EQU 28
CYDEV_CHIP_MEMBER_FM4 EQU 29
CYDEV_CHIP_MEMBER_PDL_FM0P_TYPE1 EQU 25
CYDEV_CHIP_MEMBER_PDL_FM0P_TYPE2 EQU 26
CYDEV_CHIP_MEMBER_PDL_FM0P_TYPE3 EQU 27
CYDEV_CHIP_MEMBER_UNKNOWN EQU 0
CYDEV_CHIP_MEMBER_USED EQU CYDEV_CHIP_MEMBER_5B
CYDEV_CHIP_DIE_EXPECT EQU CYDEV_CHIP_MEMBER_USED
CYDEV_CHIP_DIE_ACTUAL EQU CYDEV_CHIP_DIE_EXPECT
CYDEV_CHIP_REV_LEOPARD_ES1 EQU 0
CYDEV_CHIP_REV_LEOPARD_ES2 EQU 1
CYDEV_CHIP_REV_LEOPARD_ES3 EQU 3
CYDEV_CHIP_REV_LEOPARD_PRODUCTION EQU 3
CYDEV_CHIP_REV_PSOC4A_ES0 EQU 17
CYDEV_CHIP_REV_PSOC4A_PRODUCTION EQU 17
CYDEV_CHIP_REV_PSOC5LP_ES0 EQU 0
CYDEV_CHIP_REV_PSOC5LP_PRODUCTION EQU 0
CYDEV_CHIP_REV_PSOC5TM_ES0 EQU 0
CYDEV_CHIP_REV_PSOC5TM_ES1 EQU 1
CYDEV_CHIP_REV_PSOC5TM_PRODUCTION EQU 1
CYDEV_CHIP_REV_TMA4_ES EQU 17
CYDEV_CHIP_REV_TMA4_ES2 EQU 33
CYDEV_CHIP_REV_TMA4_PRODUCTION EQU 17
CYDEV_CHIP_REVISION_3A_ES1 EQU 0
CYDEV_CHIP_REVISION_3A_ES2 EQU 1
CYDEV_CHIP_REVISION_3A_ES3 EQU 3
CYDEV_CHIP_REVISION_3A_PRODUCTION EQU 3
CYDEV_CHIP_REVISION_4A_ES0 EQU 17
CYDEV_CHIP_REVISION_4A_PRODUCTION EQU 17
CYDEV_CHIP_REVISION_4D_PRODUCTION EQU 0
CYDEV_CHIP_REVISION_4E_CCG2_NO_USBPD EQU 0
CYDEV_CHIP_REVISION_4E_PRODUCTION EQU 0
CYDEV_CHIP_REVISION_4F_PRODUCTION EQU 0
CYDEV_CHIP_REVISION_4F_PRODUCTION_256DMA EQU 0
CYDEV_CHIP_REVISION_4F_PRODUCTION_256K EQU 0
CYDEV_CHIP_REVISION_4G_ES EQU 17
CYDEV_CHIP_REVISION_4G_ES2 EQU 33
CYDEV_CHIP_REVISION_4G_PRODUCTION EQU 17
CYDEV_CHIP_REVISION_4H_PRODUCTION EQU 0
CYDEV_CHIP_REVISION_4I_PRODUCTION EQU 0
CYDEV_CHIP_REVISION_4J_PRODUCTION EQU 0
CYDEV_CHIP_REVISION_4K_PRODUCTION EQU 0
CYDEV_CHIP_REVISION_4L_PRODUCTION EQU 0
CYDEV_CHIP_REVISION_4M_PRODUCTION EQU 0
CYDEV_CHIP_REVISION_4N_PRODUCTION EQU 0
CYDEV_CHIP_REVISION_4O_PRODUCTION EQU 0
CYDEV_CHIP_REVISION_4P_PRODUCTION EQU 0
CYDEV_CHIP_REVISION_4Q_PRODUCTION EQU 0
CYDEV_CHIP_REVISION_4R_PRODUCTION EQU 0
CYDEV_CHIP_REVISION_4S_PRODUCTION EQU 0
CYDEV_CHIP_REVISION_4T_PRODUCTION EQU 0
CYDEV_CHIP_REVISION_4U_PRODUCTION EQU 0
CYDEV_CHIP_REVISION_4V_PRODUCTION EQU 0
CYDEV_CHIP_REVISION_5A_ES0 EQU 0
CYDEV_CHIP_REVISION_5A_ES1 EQU 1
CYDEV_CHIP_REVISION_5A_PRODUCTION EQU 1
CYDEV_CHIP_REVISION_5B_ES0 EQU 0
CYDEV_CHIP_REVISION_5B_PRODUCTION EQU 0
CYDEV_CHIP_REVISION_6A_ES EQU 17
CYDEV_CHIP_REVISION_6A_NO_UDB EQU 33
CYDEV_CHIP_REVISION_6A_PRODUCTION EQU 33
CYDEV_CHIP_REVISION_FM3_PRODUCTION EQU 0
CYDEV_CHIP_REVISION_FM4_PRODUCTION EQU 0
CYDEV_CHIP_REVISION_PDL_FM0P_TYPE1_PRODUCTION EQU 0
CYDEV_CHIP_REVISION_PDL_FM0P_TYPE2_PRODUCTION EQU 0
CYDEV_CHIP_REVISION_PDL_FM0P_TYPE3_PRODUCTION EQU 0
CYDEV_CHIP_REVISION_USED EQU CYDEV_CHIP_REVISION_5B_PRODUCTION
CYDEV_CHIP_REV_EXPECT EQU CYDEV_CHIP_REVISION_USED
CYDEV_CONFIG_FASTBOOT_ENABLED EQU 1
CYDEV_CONFIG_UNUSED_IO_AllowButWarn EQU 0
CYDEV_CONFIG_UNUSED_IO EQU CYDEV_CONFIG_UNUSED_IO_AllowButWarn
CYDEV_CONFIG_UNUSED_IO_AllowWithInfo EQU 1
CYDEV_CONFIG_UNUSED_IO_Disallowed EQU 2
CYDEV_CONFIGURATION_COMPRESSED EQU 1
CYDEV_CONFIGURATION_DMA EQU 0
CYDEV_CONFIGURATION_ECC EQU 1
CYDEV_CONFIGURATION_IMOENABLED EQU CYDEV_CONFIG_FASTBOOT_ENABLED
CYDEV_CONFIGURATION_MODE_COMPRESSED EQU 0
CYDEV_CONFIGURATION_MODE EQU CYDEV_CONFIGURATION_MODE_COMPRESSED
CYDEV_CONFIGURATION_MODE_DMA EQU 2
CYDEV_CONFIGURATION_MODE_UNCOMPRESSED EQU 1
CYDEV_DEBUG_ENABLE_MASK EQU 0x20
CYDEV_DEBUG_ENABLE_REGISTER EQU CYREG_MLOGIC_DEBUG
CYDEV_DEBUGGING_DPS_Disable EQU 3
CYDEV_DEBUGGING_DPS EQU CYDEV_DEBUGGING_DPS_Disable
CYDEV_DEBUGGING_DPS_JTAG_4 EQU 1
CYDEV_DEBUGGING_DPS_JTAG_5 EQU 0
CYDEV_DEBUGGING_DPS_SWD EQU 2
CYDEV_DEBUGGING_DPS_SWD_SWV EQU 6
CYDEV_DEBUGGING_ENABLE EQU 0
CYDEV_DEBUGGING_XRES EQU 0
CYDEV_DMA_CHANNELS_AVAILABLE EQU 24
CYDEV_ECC_ENABLE EQU 0
CYDEV_HEAP_SIZE EQU 0x80
CYDEV_INSTRUCT_CACHE_ENABLED EQU 1
CYDEV_INTR_RISING EQU 0x00000000
CYDEV_IS_EXPORTING_CODE EQU 0
CYDEV_IS_IMPORTING_CODE EQU 0
CYDEV_PROJ_TYPE EQU 0
CYDEV_PROJ_TYPE_BOOTLOADER EQU 1
CYDEV_PROJ_TYPE_LAUNCHER EQU 5
CYDEV_PROJ_TYPE_LOADABLE EQU 2
CYDEV_PROJ_TYPE_LOADABLEANDBOOTLOADER EQU 4
CYDEV_PROJ_TYPE_MULTIAPPBOOTLOADER EQU 3
CYDEV_PROJ_TYPE_STANDARD EQU 0
CYDEV_PROTECTION_ENABLE EQU 1
CYDEV_STACK_SIZE EQU 0x0800
CYDEV_USB_CLK_OSC_LOCKING_ENABLED_AT_PWR_UP EQU 1
CYDEV_USE_BUNDLED_CMSIS EQU 1
CYDEV_VARIABLE_VDDA EQU 0
CYDEV_VDDA_MV EQU 5000
CYDEV_VDDD_MV EQU 5000
CYDEV_VDDIO0_MV EQU 5000
CYDEV_VDDIO1_MV EQU 5000
CYDEV_VDDIO2_MV EQU 5000
CYDEV_VDDIO3_MV EQU 5000
CYDEV_VIO0_MV EQU 5000
CYDEV_VIO1_MV EQU 5000
CYDEV_VIO2_MV EQU 5000
CYDEV_VIO3_MV EQU 5000
CYIPBLOCK_ARM_CM3_VERSION EQU 0
CYIPBLOCK_P3_ANAIF_VERSION EQU 0
CYIPBLOCK_P3_CAN_VERSION EQU 0
CYIPBLOCK_P3_CAPSENSE_VERSION EQU 0
CYIPBLOCK_P3_COMP_VERSION EQU 0
CYIPBLOCK_P3_DECIMATOR_VERSION EQU 0
CYIPBLOCK_P3_DFB_VERSION EQU 0
CYIPBLOCK_P3_DMA_VERSION EQU 0
CYIPBLOCK_P3_DRQ_VERSION EQU 0
CYIPBLOCK_P3_DSM_VERSION EQU 0
CYIPBLOCK_P3_EMIF_VERSION EQU 0
CYIPBLOCK_P3_I2C_VERSION EQU 0
CYIPBLOCK_P3_LCD_VERSION EQU 0
CYIPBLOCK_P3_LPF_VERSION EQU 0
CYIPBLOCK_P3_OPAMP_VERSION EQU 0
CYIPBLOCK_P3_PM_VERSION EQU 0
CYIPBLOCK_P3_SCCT_VERSION EQU 0
CYIPBLOCK_P3_TIMER_VERSION EQU 0
CYIPBLOCK_P3_USB_VERSION EQU 0
CYIPBLOCK_P3_VIDAC_VERSION EQU 0
CYIPBLOCK_P3_VREF_VERSION EQU 0
CYIPBLOCK_S8_GPIO_VERSION EQU 0
CYIPBLOCK_S8_IRQ_VERSION EQU 0
CYIPBLOCK_S8_SAR_VERSION EQU 0
CYIPBLOCK_S8_SIO_VERSION EQU 0
CYIPBLOCK_S8_UDB_VERSION EQU 0
DMA_CHANNELS_USED__MASK0 EQU 0x00000000
CYDEV_BOOTLOADER_ENABLE EQU 0
    ENDIF
    END
